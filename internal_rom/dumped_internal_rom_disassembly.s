; dasmfw: Disassembler Framework V0.30
; Loaded: binary file "dumped_internal_rom.bin"
; Loaded: Info file "dumped_internal_rom.info"


;****************************************************
; Used Labels
;****************************************************

P1_DDR  equ     $0000
P2_DDR  equ     $0001
P1_DR   equ     $0002
P2_DR_MR equ    $0003
P3_DDR  equ     $0004
P4_DDR  equ     $0005
P3_DR   equ     $0006
P4_DR   equ     $0007
TIMER_CSR
        equ     $0008
TIMER_OUT_COMP_H
        equ     $000B
M000D   equ     $000D
M000E   equ     $000E
SCI_RMCR equ    $0010
SCI_TRCSR
        equ     $0011
SCI_RDR equ     $0012
SCI_TDR equ     $0013
M0020   equ     $0020
M0025   equ     $0025
M0040   equ     $0040
M005F   equ     $005F
M0072   equ     $0072
M0080   equ     $0080
M0081   equ     $0081
M0082   equ     $0082
M0083   equ     $0083
M0084   equ     $0084
M0085   equ     $0085
M008B   equ     $008B
M008C   equ     $008C
M008D   equ     $008D
M008E   equ     $008E
M008F   equ     $008F
M0090   equ     $0090
M0091   equ     $0091
M0092   equ     $0092
M0093   equ     $0093
M0094   equ     $0094
M0095   equ     $0095
M0096   equ     $0096
M0097   equ     $0097
M0098   equ     $0098
M0099   equ     $0099
M009A   equ     $009A
M009B   equ     $009B
M009C   equ     $009C
M009D   equ     $009D
M009E   equ     $009E
M009F   equ     $009F
M00A0   equ     $00A0
M00A1   equ     $00A1
M00A2   equ     $00A2
M00A3   equ     $00A3
M00A4   equ     $00A4
M00A5   equ     $00A5
M00A6   equ     $00A6
M00A7   equ     $00A7
M00A8   equ     $00A8
M00A9   equ     $00A9
M00AA   equ     $00AA
M00AB   equ     $00AB
M00AC   equ     $00AC
M00AD   equ     $00AD
M00AE   equ     $00AE
M00AF   equ     $00AF
M00B0   equ     $00B0
M00B1   equ     $00B1
M00B3   equ     $00B3
M00B4   equ     $00B4
M00B5   equ     $00B5
M00B6   equ     $00B6
M00B7   equ     $00B7
M00B8   equ     $00B8
M00B9   equ     $00B9
M00BB   equ     $00BB
M00BC   equ     $00BC
M00BD   equ     $00BD
M00BF   equ     $00BF
M00C0   equ     $00C0
M00C8   equ     $00C8
M00CD   equ     $00CD
M00CE   equ     $00CE
M00D0   equ     $00D0
M00D1   equ     $00D1
TMP_0   equ     $00D2
TMP_1   equ     $00D3
Bitfield_mystery
        equ     $00D4
M00D5   equ     $00D5
M00D6   equ     $00D6
M00D8   equ     $00D8
M00DA   equ     $00DA
M00DC   equ     $00DC
M00DE   equ     $00DE
M00E0   equ     $00E0
M00E1   equ     $00E1
M00E2   equ     $00E2
M00E3   equ     $00E3
M00E4   equ     $00E4
M00E5   equ     $00E5
M00E6   equ     $00E6
M00E7   equ     $00E7
M00E8   equ     $00E8
ROM_checksum
        equ     $00E9
M00EA   equ     $00EA
M00EB   equ     $00EB
M00FE   equ     $00FE
M00FF   equ     $00FF
M0179   equ     $0179
M0271   equ     $0271
M0275   equ     $0275
M0300   equ     $0300
M0380   equ     $0380
M0400   equ     $0400
M0F54   equ     $0F54
M1000   equ     $1000
M1166   equ     $1166
M1B06   equ     $1B06
M2200   equ     $2200
M3C20   equ     $3C20
M5300   equ     $5300
M717F   equ     $717F
M8000   equ     $8000
MCB57   equ     $CB57

;****************************************************
; Program's Code Areas
;****************************************************


        org     $F000

MF000   fcb     $A5,$02,$00             ; F000: A5 02 00       '...'
        fcc     "r"                     ; F003: 72             'r'
        fcb     $A5,$05,$00,$80,$A9,$01 ; F004: A5 05 00 80 A9 01 '......'
        fcc     "yc"                    ; F00A: 79 63          'yc'
        fcb     $00,$0B,$00             ; F00C: 00 0B 00       '...'
        fcc     "%"                     ; F00F: 25             '%'
        fcb     $00,$0B,$0C             ; F010: 00 0B 0C       '...'
        fcc     "%"                     ; F013: 25             '%'
        fcb     $00,$0B,$18             ; F014: 00 0B 18       '...'
        fcc     "%"                     ; F017: 25             '%'
        fcb     $00,$0B                 ; F018: 00 0B          '..'
        fcc     "$%"                    ; F01A: 24 25          '$%'
        fcb     $00,$0B                 ; F01C: 00 0B          '..'
        fcc     "0%"                    ; F01E: 30 25          '0%'
        fcb     $00,$0B                 ; F020: 00 0B          '..'
        fcc     "<%"                    ; F022: 3C 25          '<%'
        fcb     $00,$0B                 ; F024: 00 0B          '..'
        fcc     "H%"                    ; F026: 48 25          'H%'
        fcb     $00,$0B,$00             ; F028: 00 0B 00       '...'
        fcc     "%"                     ; F02B: 25             '%'
        fcb     $00,$0B,$00             ; F02C: 00 0B 00       '...'
        fcc     "%"                     ; F02F: 25             '%'
        fcb     $A1,$03                 ; F030: A1 03          '..'
        fcc     "t"                     ; F032: 74             't'
        fcb     $03,$93,$0E             ; F033: 03 93 0E       '...'
        fcc     "f"                     ; F036: 66             'f'
        fcb     $03,$80,$04,$00,$80,$00 ; F037: 03 80 04 00 80 00 '......'
        fcb     $0B,$00,$88,$C0,$0F     ; F03D: 0B 00 88 C0 0F '.....'
        fcc     "TK"                    ; F042: 54 4B          'TK'
        fcb     $EB,$00,$00,$80,$EA,$00 ; F044: EB 00 00 80 EA 00 '......'
        fcb     $00,$02,$AB,$01,$00,$02 ; F04A: 00 02 AB 01 00 02 '......'
        fcb     $E9,$00,$00,$80,$AF,$00 ; F050: E9 00 00 80 AF 00 '......'
        fcb     $00                     ; F056: 00             '.'
MF057   fcb     $02,$00,$03,$03,$06,$01 ; F057: 02 00 03 03 06 01 '......'
        fcb     $04,$06,$02,$05,$00,$FF ; F05D: 04 06 02 05 00 FF '......'
        fcb     $00,$FF,$00,$FF,$00     ; F063: 00 FF 00 FF 00 '.....'
MF068   fcb     $03,$05,$00,$F7,$01,$15 ; F068: 03 05 00 F7 01 15 '......'
        fcb     $01,$0B,$01,$15,$00     ; F06E: 01 0B 01 15 00 '.....'
MF073   fcc     "@"                     ; F073: 40             '@'
        fcb     $0A,$09,$09,$0B,$06     ; F074: 0A 09 09 0B 06 '.....'
MF079   fcb     $01,$02,$04,$08,$10     ; F079: 01 02 04 08 10 '.....'
        fcc     " @"                    ; F07E: 20 40          ' @'
        fcb     $1F                     ; F080: 1F             '.'
        fcc     "?`"                    ; F081: 3F 60          '?`'
        fcb     $7F                     ; F083: 7F             '.'
MF084   fcb     $00                     ; F084: 00             '.'
        fcc     "H"                     ; F085: 48             'H'
        fcb     $90                     ; F086: 90             '.'
MF087   fcb     $03,$07,$0F             ; F087: 03 07 0F       '...'
MF08A   fcb     $04,$08,$10,$18,$FF,$00 ; F08A: 04 08 10 18 FF 00 '......'

vec_IRQ_EXT
        ldd     #MFF0F                  ; F090: CC FF 0F       '...'
; Set all P1 pins to output
        staa    P1_DDR                  ; F093: 97 00          '..'
; Output 0F on P1
        stab    P1_DR                   ; F095: D7 02          '..'
        ldaa    #%00010010              ; F097: 86 12          '..'
; Set P2.4 and P2.1 as output, P2.3,P2.2,P2.0 as input
        staa    P2_DDR                  ; F099: 97 01          '..'
; Output 1 on P2.4, P2.1
        staa    P2_DR_MR                ; F09B: 97 03          '..'
; Set up P3
        ldd     #M3C20                  ; F09D: CC 3C 20       '.< '
        staa    P3_DDR                  ; F0A0: 97 04          '..'
        stab    P3_DR                   ; F0A2: D7 06          '..'
; Set up P4 - top 4 bits output / bottom 4 input
        ldd     #MF0C0                  ; F0A4: CC F0 C0       '...'
        staa    P4_DDR                  ; F0A7: 97 05          '..'
        stab    P4_DR                   ; F0A9: D7 07          '..'
; Init stack to 00FF (top of internal RAM)
        lds     #M00FF                  ; F0AB: 8E 00 FF       '...'
; Set up timer: enable output compare and input capture IRQ
        ldab    #%00011000              ; F0AE: C6 18          '..'
        stab    TIMER_CSR               ; F0B0: D7 08          '..'
; Run a few RAM tests with various bit patterns
        ldaa    #$55                    ; F0B2: 86 55          '.U'
        bsr     RAM_self_test           ; F0B4: 8D 08          '..'
        asla                            ; F0B6: 48             'H'
        bsr     RAM_self_test           ; F0B7: 8D 05          '..'
; Initialize RAM to 0
        clra                            ; F0B9: 4F             'O'
        bsr     RAM_self_test           ; F0BA: 8D 02          '..'
        bra     startup                 ; F0BC: 20 14          ' .'

; RAM Self-test. The code writes the value in A to every location in
; RAM then reads it back again. If the test fails P3.3 goes high.
RAM_self_test
        ldx     #M0080                  ; F0BE: CE 00 80       '...'
ZF0C1   staa    $00,x                   ; F0C1: A7 00          '..'
        ldab    $00,x                   ; F0C3: E6 00          '..'
        cba                             ; F0C5: 11             '.'
        beq     ZF0CB                   ; F0C6: 27 03          ''.'
        oim     #%00001000,P3_DR        ; F0C8: 72 08 06       'r..'
ZF0CB   inx                             ; F0CB: 08             '.'
        cpx     #M00FE                  ; F0CC: 8C 00 FE       '...'
        bcs     ZF0C1                   ; F0CF: 25 F0          '%.'
        rts                             ; F0D1: 39             '9'

startup oim     #%00001000,P1_DR        ; F0D2: 72 08 02       'r..'
        ldx     #MF000                  ; F0D5: CE F0 00       '...'
        clra                            ; F0D8: 4F             'O'
; XOR the entire rom contents
ZF0D9   eora    $00,x                   ; F0D9: A8 00          '..'
        inx                             ; F0DB: 08             '.'
        bne     ZF0D9                   ; F0DC: 26 FB          '&.'
        staa    ROM_checksum            ; F0DE: 97 E9          '..'
; Clear top bit of bitfield(?)
        aim     #$EF,Bitfield_mystery   ; F0E0: 71 EF D4       'q..'
        ldd     #M1166                  ; F0E3: CC 11 66       '..f'
        std     TMP_0                   ; F0E6: DD D2          '..'
        ldx     #M0093                  ; F0E8: CE 00 93       '...'
        jsr     startup_p4_bitflipping_orchestrator ; F0EB: BD F8 F4       '...'
        ldd     #M0F54                  ; F0EE: CC 0F 54       '..T'
        std     TMP_0                   ; F0F1: DD D2          '..'
        ldx     #M00C0                  ; F0F3: CE 00 C0       '...'
        jsr     startup_p4_bitflipping_orchestrator ; F0F6: BD F8 F4       '...'
        ldd     #M0179                  ; F0F9: CC 01 79       '..y'
        std     TMP_0                   ; F0FC: DD D2          '..'
        ldx     #M00A9                  ; F0FE: CE 00 A9       '...'
        jsr     startup_p4_bitflipping_orchestrator ; F101: BD F8 F4       '...'
        aim     #$40,M00AA              ; F104: 71 40 AA       'q@.'
        ldd     #M1B06                  ; F107: CC 1B 06       '...'
        stab    SCI_RMCR                ; F10A: D7 10          '..'
        staa    SCI_TRCSR               ; F10C: 97 11          '..'
        cli                             ; F10E: 0E             '.'
ZF10F   ldab    #$10                    ; F10F: C6 10          '..'
        aim     #$EF,M00AA              ; F111: 71 EF AA       'q..'
ZF114   aim     #$0F,P1_DR              ; F114: 71 0F 02       'q..'
        ldx     #P4_DDR                 ; F117: CE 00 05       '...'
        stx     M00DA                   ; F11A: DF DA          '..'
        oim     #$02,M00E0              ; F11C: 72 02 E0       'r..'
ZF11F   tim     #$02,M00E0              ; F11F: 7B 02 E0       '{..'
        bne     ZF11F                   ; F122: 26 FB          '&.'
        tba                             ; F124: 17             '.'
        tim     #$02,P3_DR              ; F125: 7B 02 06       '{..'
        beq     ZF130                   ; F128: 27 06          ''.'
        cmpb    #$20                    ; F12A: C1 20          '. '
        bne     ZF130                   ; F12C: 26 02          '&.'
        ldaa    #$10                    ; F12E: 86 10          '..'
ZF130   adda    P1_DR                   ; F130: 9B 02          '..'
        staa    P1_DR                   ; F132: 97 02          '..'
        ldx     #M0040                  ; F134: CE 00 40       '..@'
        stx     M00DA                   ; F137: DF DA          '..'
        oim     #$02,M00E0              ; F139: 72 02 E0       'r..'
ZF13C   pshb                            ; F13C: 37             '7'
        jsr     ZFC87                   ; F13D: BD FC 87       '...'
        jsr     ZFB1F                   ; F140: BD FB 1F       '...'
        pulb                            ; F143: 33             '3'
        tim     #$02,M00E0              ; F144: 7B 02 E0       '{..'
        bne     ZF13C                   ; F147: 26 F3          '&.'
        aslb                            ; F149: 58             'X'
        bcc     ZF114                   ; F14A: 24 C8          '$.'
        aim     #$FD,M00EA              ; F14C: 71 FD EA       'q..'
        tim     #$40,P3_DR              ; F14F: 7B 40 06       '{@.'
        bne     ZF157                   ; F152: 26 03          '&.'
        jsr     ZF855                   ; F154: BD F8 55       '..U'
ZF157   ldaa    M0081                   ; F157: 96 81          '..'
        staa    M00AB                   ; F159: 97 AB          '..'
        clr     M00AE                   ; F15B: 7F 00 AE       '...'
        ldd     #M1000                  ; F15E: CC 10 00       '...'
        std     M00AC                   ; F161: DD AC          '..'
ZF163   aim     #$EF,M00E2              ; F163: 71 EF E2       'q..'
        tim     #$02,M00EA              ; F166: 7B 02 EA       '{..'
        bne     ZF10F                   ; F169: 26 A4          '&.'
        tim     #$40,P3_DR              ; F16B: 7B 40 06       '{@.'
        bne     ZF182                   ; F16E: 26 12          '&.'
        tim     #$80,P3_DR              ; F170: 7B 80 06       '{..'
        bne     ZF17F                   ; F173: 26 0A          '&.'
        tim     #$80,M00E0              ; F175: 7B 80 E0       '{..'
        beq     ZF182                   ; F178: 27 08          ''.'
        jsr     ZF855                   ; F17A: BD F8 55       '..U'
        bra     ZF182                   ; F17D: 20 03          ' .'
ZF17F   oim     #$80,M00E0              ; F17F: 72 80 E0       'r..'
ZF182   ldx     M00A6                   ; F182: DE A6          '..'
        cpx     #M0400                  ; F184: 8C 04 00       '...'
        bcc     ZF1AB                   ; F187: 24 22          '$"'
        tim     #$40,M00AA              ; F189: 7B 40 AA       '{@.'
        bne     ZF1FB                   ; F18C: 26 6D          '&m'
        oim     #$40,M00AA              ; F18E: 72 40 AA       'r@.'
        ldaa    M00AC                   ; F191: 96 AC          '..'
        cmpa    #$05                    ; F193: 81 05          '..'
        bhi     ZF19A                   ; F195: 22 03          '".'
        oim     #$04,M00AA              ; F197: 72 04 AA       'r..'
ZF19A   cmpa    #$1B                    ; F19A: 81 1B          '..'
        bcs     ZF1A1                   ; F19C: 25 03          '%.'
        oim     #$02,M00AA              ; F19E: 72 02 AA       'r..'
ZF1A1   dec     M00A9                   ; F1A1: 7A 00 A9       'z..'
        bpl     ZF1DC                   ; F1A4: 2A 36          '*6'
        clr     M00A9                   ; F1A6: 7F 00 A9       '...'
        bra     ZF1DC                   ; F1A9: 20 31          ' 1'
ZF1AB   tim     #$40,M00AA              ; F1AB: 7B 40 AA       '{@.'
        beq     ZF1FB                   ; F1AE: 27 4B          ''K'
        aim     #$BF,M00AA              ; F1B0: 71 BF AA       'q..'
        tst     M00A2                   ; F1B3: 7D 00 A2       '}..'
        bmi     ZF1DC                   ; F1B6: 2B 24          '+$'
        ldaa    M00A4                   ; F1B8: 96 A4          '..'
        ldab    M0099                   ; F1BA: D6 99          '..'
        addb    #$78                    ; F1BC: CB 78          '.x'
        cmpb    M0081                   ; F1BE: D1 81          '..'
        bcc     ZF1CE                   ; F1C0: 24 0C          '$.'
        inca                            ; F1C2: 4C             'L'
        cmpa    #$02                    ; F1C3: 81 02          '..'
        bls     ZF1DA                   ; F1C5: 23 13          '#.'
        ldaa    #$05                    ; F1C7: 86 05          '..'
        oim     #$40,M00A2              ; F1C9: 72 40 A2       'r@.'
        bra     ZF1DA                   ; F1CC: 20 0C          ' .'
ZF1CE   tsta                            ; F1CE: 4D             'M'
        beq     ZF1DA                   ; F1CF: 27 09          ''.'
        deca                            ; F1D1: 4A             'J'
        cmpa    #$02                    ; F1D2: 81 02          '..'
        bhi     ZF1DA                   ; F1D4: 22 04          '".'
        clra                            ; F1D6: 4F             'O'
        aim     #$BF,M00A2              ; F1D7: 71 BF A2       'q..'
ZF1DA   staa    M00A4                   ; F1DA: 97 A4          '..'
ZF1DC   aim     #$EF,SCI_TRCSR          ; F1DC: 71 EF 11       'q..'
        ldd     #M0179                  ; F1DF: CC 01 79       '..y'
        std     TMP_0                   ; F1E2: DD D2          '..'
        ldx     #M00A9                  ; F1E4: CE 00 A9       '...'
        aim     #$EF,Bitfield_mystery   ; F1E7: 71 EF D4       'q..'
        jsr     ZF906                   ; F1EA: BD F9 06       '...'
        ldd     #M0275                  ; F1ED: CC 02 75       '..u'
        std     TMP_0                   ; F1F0: DD D2          '..'
        ldx     #M00A2                  ; F1F2: CE 00 A2       '...'
        jsr     ZF906                   ; F1F5: BD F9 06       '...'
        oim     #$10,SCI_TRCSR          ; F1F8: 72 10 11       'r..'
ZF1FB   ldaa    M00A7                   ; F1FB: 96 A7          '..'
        anda    #$1F                    ; F1FD: 84 1F          '..'
        bne     ZF218                   ; F1FF: 26 17          '&.'
        tim     #$40,M00E0              ; F201: 7B 40 E0       '{@.'
        bne     ZF21B                   ; F204: 26 15          '&.'
        oim     #$40,M00E0              ; F206: 72 40 E0       'r@.'
        tst     M00D5                   ; F209: 7D 00 D5       '}..'
        beq     ZF213                   ; F20C: 27 05          ''.'
        dec     M00D5                   ; F20E: 7A 00 D5       'z..'
        bra     ZF21B                   ; F211: 20 08          ' .'
ZF213   aim     #$F7,M00E1              ; F213: 71 F7 E1       'q..'
        bra     ZF21B                   ; F216: 20 03          ' .'
ZF218   aim     #$BF,M00E0              ; F218: 71 BF E0       'q..'
ZF21B   ldab    M00A3                   ; F21B: D6 A3          '..'
        lsrb                            ; F21D: 54             'T'
        lsrb                            ; F21E: 54             'T'
        lsrb                            ; F21F: 54             'T'
        lsrb                            ; F220: 54             'T'
        ldx     #MF087                  ; F221: CE F0 87       '...'
        abx                             ; F224: 3A             ':'
        ldaa    M00A7                   ; F225: 96 A7          '..'
        anda    $00,x                   ; F227: A4 00          '..'
        tsta                            ; F229: 4D             'M'
        beq     ZF232                   ; F22A: 27 06          ''.'
        aim     #$BF,M00E1              ; F22C: 71 BF E1       'q..'
ZF22F   jmp     ZF2B8                   ; F22F: 7E F2 B8       '~..'
ZF232   tim     #$40,M00E1              ; F232: 7B 40 E1       '{@.'
        bne     ZF22F                   ; F235: 26 F8          '&.'
        oim     #$40,M00E1              ; F237: 72 40 E1       'r@.'
        ldab    M00AE                   ; F23A: D6 AE          '..'
        ldaa    M00AB                   ; F23C: 96 AB          '..'
        aslb                            ; F23E: 58             'X'
        sbca    #$00                    ; F23F: 82 00          '..'
        ldab    #$FF                    ; F241: C6 FF          '..'
        mul                             ; F243: 3D             '='
        addb    M0081                   ; F244: DB 81          '..'
        adca    #$00                    ; F246: 89 00          '..'
        xgdx                            ; F248: 18             '.'
        ldaa    M00AE                   ; F249: 96 AE          '..'
        ldab    #$FF                    ; F24B: C6 FF          '..'
        mul                             ; F24D: 3D             '='
        aslb                            ; F24E: 58             'X'
        adca    #$00                    ; F24F: 89 00          '..'
        tab                             ; F251: 16             '.'
        abx                             ; F252: 3A             ':'
        xgdx                            ; F253: 18             '.'
        stab    M00AE                   ; F254: D7 AE          '..'
        aslb                            ; F256: 58             'X'
        adca    #$00                    ; F257: 89 00          '..'
        staa    M00AB                   ; F259: 97 AB          '..'
        ldaa    M00AF                   ; F25B: 96 AF          '..'
        tsta                            ; F25D: 4D             'M'
        bpl     ZF261                   ; F25E: 2A 01          '*.'
        nega                            ; F260: 40             '@'
ZF261   deca                            ; F261: 4A             'J'
        bpl     ZF265                   ; F262: 2A 01          '*.'
        clra                            ; F264: 4F             'O'
ZF265   tst     M00AF                   ; F265: 7D 00 AF       '}..'
        bpl     ZF26B                   ; F268: 2A 01          '*.'
        nega                            ; F26A: 40             '@'
ZF26B   staa    M00AF                   ; F26B: 97 AF          '..'
        tim     #$80,M00A8              ; F26D: 7B 80 A8       '{..'
        beq     ZF2B8                   ; F270: 27 46          ''F'
        tim     #$02,M00E1              ; F272: 7B 02 E1       '{..'
        bne     ZF2B8                   ; F275: 26 41          '&A'
        tim     #$10,M00E1              ; F277: 7B 10 E1       '{..'
        bne     ZF2B8                   ; F27A: 26 3C          '&<'
        ldaa    M00EB                   ; F27C: 96 EB          '..'
        cmpa    #$A8                    ; F27E: 81 A8          '..'
        beq     ZF2B8                   ; F280: 27 36          ''6'
        ldd     M00AC                   ; F282: DC AC          '..'
        aslb                            ; F284: 58             'X'
        sbca    #$00                    ; F285: 82 00          '..'
        ldab    #$1F                    ; F287: C6 1F          '..'
        mul                             ; F289: 3D             '='
        xgdx                            ; F28A: 18             '.'
        ldab    M0093                   ; F28B: D6 93          '..'
        addb    #$60                    ; F28D: CB 60          '.`'
        subb    M0084                   ; F28F: D0 84          '..'
        bcc     ZF294                   ; F291: 24 01          '$.'
        clrb                            ; F293: 5F             '_'
ZF294   cmpb    #$20                    ; F294: C1 20          '. '
        bls     ZF29A                   ; F296: 23 02          '#.'
        ldab    #$20                    ; F298: C6 20          '. '
ZF29A   abx                             ; F29A: 3A             ':'
        ldaa    M00AD                   ; F29B: 96 AD          '..'
        ldab    #$1F                    ; F29D: C6 1F          '..'
        mul                             ; F29F: 3D             '='
        aslb                            ; F2A0: 58             'X'
        adca    #$00                    ; F2A1: 89 00          '..'
        tab                             ; F2A3: 16             '.'
        abx                             ; F2A4: 3A             ':'
        xgdx                            ; F2A5: 18             '.'
        asld                            ; F2A6: 05             '.'
        asld                            ; F2A7: 05             '.'
        asld                            ; F2A8: 05             '.'
        tim     #$01,M00A1              ; F2A9: 7B 01 A1       '{..'
        bne     ZF2B1                   ; F2AC: 26 03          '&.'
        ldd     #M1000                  ; F2AE: CC 10 00       '...'
ZF2B1   stab    M00AD                   ; F2B1: D7 AD          '..'
        aslb                            ; F2B3: 58             'X'
        adca    #$00                    ; F2B4: 89 00          '..'
        staa    M00AC                   ; F2B6: 97 AC          '..'
ZF2B8   tim     #$06,M00AA              ; F2B8: 7B 06 AA       '{..'
        bne     ZF2C0                   ; F2BB: 26 03          '&.'
        jmp     ZF35F                   ; F2BD: 7E F3 5F       '~._'
ZF2C0   clrb                            ; F2C0: 5F             '_'
ZF2C1   pshb                            ; F2C1: 37             '7'
        ldaa    #$10                    ; F2C2: 86 10          '..'
        mul                             ; F2C4: 3D             '='
        ldaa    M00AB                   ; F2C5: 96 AB          '..'
        sba                             ; F2C7: 10             '.'
        bcc     ZF2CB                   ; F2C8: 24 01          '$.'
        nega                            ; F2CA: 40             '@'
ZF2CB   ldab    #$03                    ; F2CB: C6 03          '..'
        mul                             ; F2CD: 3D             '='
        tsta                            ; F2CE: 4D             'M'
        bne     ZF2D5                   ; F2CF: 26 04          '&.'
        cmpb    #$F7                    ; F2D1: C1 F7          '..'
        bls     ZF2D7                   ; F2D3: 23 02          '#.'
ZF2D5   ldab    #$F7                    ; F2D5: C6 F7          '..'
ZF2D7   tba                             ; F2D7: 17             '.'
        mul                             ; F2D8: 3D             '='
        adda    #$10                    ; F2D9: 8B 10          '..'
        tab                             ; F2DB: 16             '.'
        mul                             ; F2DC: 3D             '='
        aim     #$EF,SCI_TRCSR          ; F2DD: 71 EF 11       'q..'
        std     M00E5                   ; F2E0: DD E5          '..'
        ldd     #M8000                  ; F2E2: CC 80 00       '...'
        std     M00E3                   ; F2E5: DD E3          '..'
        jsr     ZF6F8                   ; F2E7: BD F6 F8       '...'
        ldaa    M00E4                   ; F2EA: 96 E4          '..'
        ldab    #$30                    ; F2EC: C6 30          '.0'
        mul                             ; F2EE: 3D             '='
        std     M00E3                   ; F2EF: DD E3          '..'
        pulb                            ; F2F1: 33             '3'
        ldx     #M00C0                  ; F2F2: CE 00 C0       '...'
        abx                             ; F2F5: 3A             ':'
        ldaa    $00,x                   ; F2F6: A6 00          '..'
        tim     #$02,M00AA              ; F2F8: 7B 02 AA       '{..'
        beq     ZF310                   ; F2FB: 27 13          ''.'
        adda    M00E3                   ; F2FD: 9B E3          '..'
        asl     M00E4                   ; F2FF: 78 00 E4       'x..'
        adca    #$00                    ; F302: 89 00          '..'
        tst     $00,x                   ; F304: 6D 00          'm.'
        bmi     ZF322                   ; F306: 2B 1A          '+.'
        cmpa    #$7F                    ; F308: 81 7F          '..'
        bls     ZF322                   ; F30A: 23 16          '#.'
        ldaa    #$7F                    ; F30C: 86 7F          '..'
        bra     ZF322                   ; F30E: 20 12          ' .'
ZF310   inc     M00E3                   ; F310: 7C 00 E3       '|..'
        lsr     M00E3                   ; F313: 74 00 E3       't..'
        suba    M00E3                   ; F316: 90 E3          '..'
        tst     $00,x                   ; F318: 6D 00          'm.'
        bpl     ZF322                   ; F31A: 2A 06          '*.'
        cmpa    #$81                    ; F31C: 81 81          '..'
        bcc     ZF322                   ; F31E: 24 02          '$.'
        ldaa    #$81                    ; F320: 86 81          '..'
ZF322   oim     #$10,SCI_TRCSR          ; F322: 72 10 11       'r..'
        staa    $00,x                   ; F325: A7 00          '..'
        incb                            ; F327: 5C             '\'
        cmpb    #$0F                    ; F328: C1 0F          '..'
        bls     ZF2C1                   ; F32A: 23 95          '#.'
        clra                            ; F32C: 4F             'O'
        tim     #$01,M00A1              ; F32D: 7B 01 A1       '{..'
        bne     ZF33B                   ; F330: 26 09          '&.'
        ldaa    #$18                    ; F332: 86 18          '..'
        tim     #$02,M00AA              ; F334: 7B 02 AA       '{..'
        bne     ZF33B                   ; F337: 26 02          '&.'
        ldaa    #$F0                    ; F339: 86 F0          '..'
ZF33B   staa    M00AF                   ; F33B: 97 AF          '..'
        ldd     #M1000                  ; F33D: CC 10 00       '...'
        std     M00AC                   ; F340: DD AC          '..'
        aim     #$DF,M00E0              ; F342: 71 DF E0       'q..'
        aim     #$FE,M00EA              ; F345: 71 FE EA       'q..'
        aim     #$EF,SCI_TRCSR          ; F348: 71 EF 11       'q..'
        ldd     #M0F54                  ; F34B: CC 0F 54       '..T'
        std     TMP_0                   ; F34E: DD D2          '..'
        ldx     #M00C0                  ; F350: CE 00 C0       '...'
        aim     #$EF,Bitfield_mystery   ; F353: 71 EF D4       'q..'
        jsr     ZF906                   ; F356: BD F9 06       '...'
        oim     #$10,SCI_TRCSR          ; F359: 72 10 11       'r..'
        aim     #$F8,M00AA              ; F35C: 71 F8 AA       'q..'
ZF35F   tim     #$03,M00E2              ; F35F: 7B 03 E2       '{..'
        beq     ZF3DE                   ; F362: 27 7A          ''z'
        clra                            ; F364: 4F             'O'
        ldab    M0095                   ; F365: D6 95          '..'
        addb    M00A0                   ; F367: DB A0          '..'
        subb    #$14                    ; F369: C0 14          '..'
        bcc     ZF36E                   ; F36B: 24 01          '$.'
        clrb                            ; F36D: 5F             '_'
ZF36E   aslb                            ; F36E: 58             'X'
        addd    #M00C8                  ; F36F: C3 00 C8       '...'
        aim     #$EF,SCI_TRCSR          ; F372: 71 EF 11       'q..'
        std     M00E3                   ; F375: DD E3          '..'
        ldd     #P2_DR_MR               ; F377: CC 00 03       '...'
        std     M00E5                   ; F37A: DD E5          '..'
        jsr     ZF6F8                   ; F37C: BD F6 F8       '...'
        ldaa    M00E4                   ; F37F: 96 E4          '..'
        cmpa    M00AB                   ; F381: 91 AB          '..'
        bhi     ZF3A4                   ; F383: 22 1F          '".'
        tim     #$01,M00E2              ; F385: 7B 01 E2       '{..'
        bne     ZF397                   ; F388: 26 0D          '&.'
        ldaa    M009E                   ; F38A: 96 9E          '..'
        inca                            ; F38C: 4C             'L'
        cmpa    #$1F                    ; F38D: 81 1F          '..'
        bls     ZF393                   ; F38F: 23 02          '#.'
        ldaa    #$1F                    ; F391: 86 1F          '..'
ZF393   staa    M009E                   ; F393: 97 9E          '..'
        bra     ZF3C5                   ; F395: 20 2E          ' .'
ZF397   dec     M009E                   ; F397: 7A 00 9E       'z..'
        tst     M009E                   ; F39A: 7D 00 9E       '}..'
        bpl     ZF3C5                   ; F39D: 2A 26          '*&'
        clr     M009E                   ; F39F: 7F 00 9E       '...'
        bra     ZF3C5                   ; F3A2: 20 21          ' !'
ZF3A4   tim     #$01,M00E2              ; F3A4: 7B 01 E2       '{..'
        bne     ZF3B9                   ; F3A7: 26 10          '&.'
        dec     M00A0                   ; F3A9: 7A 00 A0       'z..'
        dec     M00A0                   ; F3AC: 7A 00 A0       'z..'
        tst     M00A0                   ; F3AF: 7D 00 A0       '}..'
        bpl     ZF3C5                   ; F3B2: 2A 11          '*.'
        clr     M00A0                   ; F3B4: 7F 00 A0       '...'
        bra     ZF3C5                   ; F3B7: 20 0C          ' .'
ZF3B9   ldaa    M00A0                   ; F3B9: 96 A0          '..'
        adda    #$02                    ; F3BB: 8B 02          '..'
        cmpa    #$28                    ; F3BD: 81 28          '.('
        bls     ZF3C3                   ; F3BF: 23 02          '#.'
        ldaa    #$28                    ; F3C1: 86 28          '.('
ZF3C3   staa    M00A0                   ; F3C3: 97 A0          '..'
ZF3C5   aim     #$FC,M00E2              ; F3C5: 71 FC E2       'q..'
        ldd     #M1000                  ; F3C8: CC 10 00       '...'
        std     M00AC                   ; F3CB: DD AC          '..'
        ldd     #M0271                  ; F3CD: CC 02 71       '..q'
        std     TMP_0                   ; F3D0: DD D2          '..'
        ldx     #M009E                  ; F3D2: CE 00 9E       '...'
        aim     #$EF,Bitfield_mystery   ; F3D5: 71 EF D4       'q..'
        jsr     ZF906                   ; F3D8: BD F9 06       '...'
        oim     #$10,SCI_TRCSR          ; F3DB: 72 10 11       'r..'
ZF3DE   jsr     ZFC87                   ; F3DE: BD FC 87       '...'
        aim     #$EF,SCI_TRCSR          ; F3E1: 71 EF 11       'q..'
        jsr     ZF4D4                   ; F3E4: BD F4 D4       '...'
        oim     #$10,SCI_TRCSR          ; F3E7: 72 10 11       'r..'
        ldaa    M0081                   ; F3EA: 96 81          '..'
        aim     #$EF,SCI_TRCSR          ; F3EC: 71 EF 11       'q..'
        jsr     ZF580                   ; F3EF: BD F5 80       '...'
        oim     #$10,SCI_TRCSR          ; F3F2: 72 10 11       'r..'
        staa    M00D6                   ; F3F5: 97 D6          '..'
        aim     #$F7,M00E2              ; F3F7: 71 F7 E2       'q..'
        adda    #$10                    ; F3FA: 8B 10          '..'
        suba    M0082                   ; F3FC: 90 82          '..'
        bcs     ZF404                   ; F3FE: 25 04          '%.'
        cmpa    #$20                    ; F400: 81 20          '. '
        bls     ZF407                   ; F402: 23 03          '#.'
ZF404   oim     #$08,M00E2              ; F404: 72 08 E2       'r..'
ZF407   tim     #$10,M00AA              ; F407: 7B 10 AA       '{..'
        beq     ZF432                   ; F40A: 27 26          ''&'
        tim     #$20,M00E2              ; F40C: 7B 20 E2       '{ .'
        bne     ZF425                   ; F40F: 26 14          '&.'
        oim     #$20,M00E2              ; F411: 72 20 E2       'r .'
        ldx     #MCB57                  ; F414: CE CB 57       '..W'
        stx     M00DC                   ; F417: DF DC          '..'
        oim     #$04,M00E0              ; F419: 72 04 E0       'r..'
        aim     #$FD,M00E0              ; F41C: 71 FD E0       'q..'
        aim     #$3F,P1_DR              ; F41F: 71 3F 02       'q?.'
        jsr     ZF4C4                   ; F422: BD F4 C4       '...'
ZF425   tim     #$04,M00E0              ; F425: 7B 04 E0       '{..'
        bne     ZF42F                   ; F428: 26 05          '&.'
        aim     #$EF,M00AA              ; F42A: 71 EF AA       'q..'
        bra     ZF432                   ; F42D: 20 03          ' .'
ZF42F   jmp     ZF4BE                   ; F42F: 7E F4 BE       '~..'
ZF432   aim     #$DF,M00E2              ; F432: 71 DF E2       'q..'
        tim     #$20,M00A2              ; F435: 7B 20 A2       '{ .'
        bne     ZF4AA                   ; F438: 26 70          '&p'
        ldaa    M0081                   ; F43A: 96 81          '..'
        cmpa    M009D                   ; F43C: 91 9D          '..'
        bcs     ZF444                   ; F43E: 25 04          '%.'
        ldab    M009C                   ; F440: D6 9C          '..'
        bra     ZF46B                   ; F442: 20 27          ' ''
ZF444   cmpa    M009B                   ; F444: 91 9B          '..'
        bhi     ZF44C                   ; F446: 22 04          '".'
        ldab    M009A                   ; F448: D6 9A          '..'
        bra     ZF46B                   ; F44A: 20 1F          ' .'
ZF44C   ldaa    M009A                   ; F44C: 96 9A          '..'
        suba    M009C                   ; F44E: 90 9C          '..'
        ldab    M009D                   ; F450: D6 9D          '..'
        subb    M0081                   ; F452: D0 81          '..'
        mul                             ; F454: 3D             '='
        aim     #$EF,SCI_TRCSR          ; F455: 71 EF 11       'q..'
        std     M00E3                   ; F458: DD E3          '..'
        ldab    M009D                   ; F45A: D6 9D          '..'
        subb    M009B                   ; F45C: D0 9B          '..'
        clra                            ; F45E: 4F             'O'
        std     M00E5                   ; F45F: DD E5          '..'
        jsr     ZF6F8                   ; F461: BD F6 F8       '...'
        ldab    M00E4                   ; F464: D6 E4          '..'
        oim     #$10,SCI_TRCSR          ; F466: 72 10 11       'r..'
        addb    M009C                   ; F469: DB 9C          '..'
ZF46B   addb    #$14                    ; F46B: CB 14          '..'
        ldaa    M0083                   ; F46D: 96 83          '..'
        tim     #$10,M00A2              ; F46F: 7B 10 A2       '{..'
        bne     ZF477                   ; F472: 26 03          '&.'
        tba                             ; F474: 17             '.'
        ldab    M0083                   ; F475: D6 83          '..'
ZF477   tim     #$20,M00E1              ; F477: 7B 20 E1       '{ .'
        bne     ZF484                   ; F47A: 26 08          '&.'
        cba                             ; F47C: 11             '.'
        bcs     ZF4AA                   ; F47D: 25 2B          '%+'
        oim     #$20,M00E1              ; F47F: 72 20 E1       'r .'
        bra     ZF489                   ; F482: 20 05          ' .'
ZF484   adda    #$04                    ; F484: 8B 04          '..'
        cba                             ; F486: 11             '.'
        bls     ZF4AA                   ; F487: 23 21          '#!'
ZF489   tim     #$08,M00A2              ; F489: 7B 08 A2       '{..'
        beq     ZF4A3                   ; F48C: 27 15          ''.'
        aim     #$3F,P1_DR              ; F48E: 71 3F 02       'q?.'
        oim     #$10,P1_DR              ; F491: 72 10 02       'r..'
        tim     #$04,M00A2              ; F494: 7B 04 A2       '{..'
        bne     ZF49E                   ; F497: 26 05          '&.'
        oim     #$20,P1_DR              ; F499: 72 20 02       'r .'
        bra     ZF4BE                   ; F49C: 20 20          '  '
ZF49E   aim     #$DF,P1_DR              ; F49E: 71 DF 02       'q..'
        bra     ZF4BE                   ; F4A1: 20 1B          ' .'
ZF4A3   jsr     ZF7E1                   ; F4A3: BD F7 E1       '...'
        bsr     ZF4C4                   ; F4A6: 8D 1C          '..'
        bra     ZF4BE                   ; F4A8: 20 14          ' .'
ZF4AA   aim     #$DF,M00E1              ; F4AA: 71 DF E1       'q..'
        jsr     ZF7E1                   ; F4AD: BD F7 E1       '...'
        tim     #$10,M00E0              ; F4B0: 7B 10 E0       '{..'
        beq     ZF4B9                   ; F4B3: 27 04          ''.'
        bsr     ZF4C4                   ; F4B5: 8D 0D          '..'
        bra     ZF4BE                   ; F4B7: 20 05          ' .'
ZF4B9   ldaa    M00D6                   ; F4B9: 96 D6          '..'
        jsr     ZF725                   ; F4BB: BD F7 25       '..%'
ZF4BE   jsr     ZFB1F                   ; F4BE: BD FB 1F       '...'
        jmp     ZF163                   ; F4C1: 7E F1 63       '~.c'
ZF4C4   aim     #$EF,P1_DR              ; F4C4: 71 EF 02       'q..'
        tim     #$40,M00A8              ; F4C7: 7B 40 A8       '{@.'
        beq     ZF4D0                   ; F4CA: 27 04          ''.'
        oim     #$20,P1_DR              ; F4CC: 72 20 02       'r .'
        rts                             ; F4CF: 39             '9'
ZF4D0   aim     #$DF,P1_DR              ; F4D0: 71 DF 02       'q..'
        rts                             ; F4D3: 39             '9'
ZF4D4   tim     #$08,M00AA              ; F4D4: 7B 08 AA       '{..'
        bne     ZF4DA                   ; F4D7: 26 01          '&.'
        rts                             ; F4D9: 39             '9'
ZF4DA   tim     #$02,M00E1              ; F4DA: 7B 02 E1       '{..'
        beq     ZF4EE                   ; F4DD: 27 0F          ''.'
        ldaa    M0093                   ; F4DF: 96 93          '..'
        adda    #$50                    ; F4E1: 8B 50          '.P'
        cmpa    M0084                   ; F4E3: 91 84          '..'
        bcc     ZF4ED                   ; F4E5: 24 06          '$.'
        oim     #$06,M00E2              ; F4E7: 72 06 E2       'r..'
        aim     #$FD,M00E1              ; F4EA: 71 FD E1       'q..'
ZF4ED   rts                             ; F4ED: 39             '9'
ZF4EE   ldab    M0095                   ; F4EE: D6 95          '..'
        addb    M00A0                   ; F4F0: DB A0          '..'
        subb    #$14                    ; F4F2: C0 14          '..'
        bcc     ZF4F7                   ; F4F4: 24 01          '$.'
        clrb                            ; F4F6: 5F             '_'
ZF4F7   pshb                            ; F4F7: 37             '7'
        ldaa    #$C8                    ; F4F8: 86 C8          '..'
        sba                             ; F4FA: 10             '.'
        ldab    M0093                   ; F4FB: D6 93          '..'
        addb    #$50                    ; F4FD: CB 50          '.P'
        subb    M0084                   ; F4FF: D0 84          '..'
        bcc     ZF504                   ; F501: 24 01          '$.'
        clrb                            ; F503: 5F             '_'
ZF504   mul                             ; F504: 3D             '='
        std     M00E3                   ; F505: DD E3          '..'
        pulb                            ; F507: 33             '3'
        pshb                            ; F508: 37             '7'
        ldaa    M0081                   ; F509: 96 81          '..'
        sba                             ; F50B: 10             '.'
        bcc     ZF50F                   ; F50C: 24 01          '$.'
        clra                            ; F50E: 4F             'O'
ZF50F   ldab    M009E                   ; F50F: D6 9E          '..'
        mul                             ; F511: 3D             '='
        xgdx                            ; F512: 18             '.'
        ldaa    #$C8                    ; F513: 86 C8          '..'
        pulb                            ; F515: 33             '3'
        sba                             ; F516: 10             '.'
        tab                             ; F517: 16             '.'
        abx                             ; F518: 3A             ':'
        xgdx                            ; F519: 18             '.'
        std     M00E5                   ; F51A: DD E5          '..'
        jsr     ZF6F8                   ; F51C: BD F6 F8       '...'
        ldd     M00E3                   ; F51F: DC E3          '..'
        tsta                            ; F521: 4D             'M'
        bne     ZF528                   ; F522: 26 04          '&.'
        cmpb    #$5F                    ; F524: C1 5F          '._'
        bls     ZF52A                   ; F526: 23 02          '#.'
ZF528   ldab    #$5F                    ; F528: C6 5F          '._'
ZF52A   stab    M009F                   ; F52A: D7 9F          '..'
        pshb                            ; F52C: 37             '7'
        ldd     M00BD                   ; F52D: DC BD          '..'
        tst     M00BF                   ; F52F: 7D 00 BF       '}..'
        beq     ZF537                   ; F532: 27 03          ''.'
        adda    #$24                    ; F534: 8B 24          '.$'
        daa                             ; F536: 19             '.'
ZF537   std     M00E3                   ; F537: DD E3          '..'
        pulb                            ; F539: 33             '3'
        ldaa    M00A7                   ; F53A: 96 A7          '..'
        lsrb                            ; F53C: 54             'T'
        bcc     ZF54A                   ; F53D: 24 0B          '$.'
        adda    #$15                    ; F53F: 8B 15          '..'
        daa                             ; F541: 19             '.'
        cmpa    #$60                    ; F542: 81 60          '.`'
        bcs     ZF54A                   ; F544: 25 04          '%.'
        adda    #$A0                    ; F546: 8B A0          '..'
        addb    #$02                    ; F548: CB 02          '..'
ZF54A   lsrb                            ; F54A: 54             'T'
        bcc     ZF556                   ; F54B: 24 09          '$.'
        adda    #$30                    ; F54D: 8B 30          '.0'
        cmpa    #$60                    ; F54F: 81 60          '.`'
        bcs     ZF556                   ; F551: 25 03          '%.'
        adda    #$A0                    ; F553: 8B A0          '..'
        incb                            ; F555: 5C             '\'
ZF556   psha                            ; F556: 36             '6'
        cmpb    #$09                    ; F557: C1 09          '..'
        bls     ZF55D                   ; F559: 23 02          '#.'
        addb    #$06                    ; F55B: CB 06          '..'
ZF55D   tba                             ; F55D: 17             '.'
        andb    #$0F                    ; F55E: C4 0F          '..'
        cmpb    #$09                    ; F560: C1 09          '..'
        bls     ZF566                   ; F562: 23 02          '#.'
        adda    #$06                    ; F564: 8B 06          '..'
ZF566   adda    M00A6                   ; F566: 9B A6          '..'
        daa                             ; F568: 19             '.'
        pulb                            ; F569: 33             '3'
        subd    M00E3                   ; F56A: 93 E3          '..'
        bmi     ZF57F                   ; F56C: 2B 11          '+.'
        oim     #$02,M00E1              ; F56E: 72 02 E1       'r..'
        ldd     #M0072                  ; F571: CC 00 72       '..r'
        std     TMP_0                   ; F574: DD D2          '..'
        ldx     #M009F                  ; F576: CE 00 9F       '...'
        aim     #$EF,Bitfield_mystery   ; F579: 71 EF D4       'q..'
        jsr     ZF906                   ; F57C: BD F9 06       '...'
ZF57F   rts                             ; F57F: 39             '9'
ZF580   tim     #$02,M00E1              ; F580: 7B 02 E1       '{..'
        beq     ZF588                   ; F583: 27 03          ''.'
        ldaa    M0094                   ; F585: 96 94          '..'
        rts                             ; F587: 39             '9'
ZF588   psha                            ; F588: 36             '6'
        ldaa    M0097                   ; F589: 96 97          '..'
        ldab    M0096                   ; F58B: D6 96          '..'
        tim     #$01,M00A1              ; F58D: 7B 01 A1       '{..'
        beq     ZF596                   ; F590: 27 04          ''.'
        ldaa    #$C8                    ; F592: 86 C8          '..'
        ldab    #$28                    ; F594: C6 28          '.('
ZF596   suba    M0095                   ; F596: 90 95          '..'
        lsra                            ; F598: 44             'D'
        lsra                            ; F599: 44             'D'
        staa    M00E6                   ; F59A: 97 E6          '..'
        clr     M00E5                   ; F59C: 7F 00 E5       '...'
        ldaa    M0094                   ; F59F: 96 94          '..'
        sba                             ; F5A1: 10             '.'
        staa    M00E3                   ; F5A2: 97 E3          '..'
        clr     M00E4                   ; F5A4: 7F 00 E4       '...'
        jsr     ZF6F8                   ; F5A7: BD F6 F8       '...'
        ldab    M0098                   ; F5AA: D6 98          '..'
        andb    #$F0                    ; F5AC: C4 F0          '..'
        lsrb                            ; F5AE: 54             'T'
        lsrb                            ; F5AF: 54             'T'
        tba                             ; F5B0: 17             '.'
        lsrb                            ; F5B1: 54             'T'
        std     M00E5                   ; F5B2: DD E5          '..'
        ldaa    M0097                   ; F5B4: 96 97          '..'
        ldab    M0096                   ; F5B6: D6 96          '..'
        tim     #$01,M00A1              ; F5B8: 7B 01 A1       '{..'
        beq     ZF5D8                   ; F5BB: 27 1B          ''.'
        ldaa    M0093                   ; F5BD: 96 93          '..'
        adda    #$50                    ; F5BF: 8B 50          '.P'
        tab                             ; F5C1: 16             '.'
        addb    #$10                    ; F5C2: CB 10          '..'
        subb    M0084                   ; F5C4: D0 84          '..'
        bcc     ZF5C9                   ; F5C6: 24 01          '$.'
        clrb                            ; F5C8: 5F             '_'
ZF5C9   cmpb    #$20                    ; F5C9: C1 20          '. '
        bls     ZF5CF                   ; F5CB: 23 02          '#.'
        ldab    #$20                    ; F5CD: C6 20          '. '
ZF5CF   lsrb                            ; F5CF: 54             'T'
        lsra                            ; F5D0: 44             'D'
        aba                             ; F5D1: 1B             '.'
        tab                             ; F5D2: 16             '.'
        lsrb                            ; F5D3: 54             'T'
        subb    #$04                    ; F5D4: C0 04          '..'
        adda    #$70                    ; F5D6: 8B 70          '.p'
ZF5D8   tim     #$80,M00A8              ; F5D8: 7B 80 A8       '{..'
        bne     ZF5FA                   ; F5DB: 26 1D          '&.'
        tim     #$08,M00E1              ; F5DD: 7B 08 E1       '{..'
        beq     ZF5E6                   ; F5E0: 27 04          ''.'
        ldaa    #$84                    ; F5E2: 86 84          '..'
        ldab    #$06                    ; F5E4: C6 06          '..'
ZF5E6   suba    M00E5                   ; F5E6: 90 E5          '..'
        cmpa    #$84                    ; F5E8: 81 84          '..'
        bhi     ZF5EE                   ; F5EA: 22 02          '".'
        ldaa    #$84                    ; F5EC: 86 84          '..'
ZF5EE   addb    #$14                    ; F5EE: CB 14          '..'
        subb    M00E6                   ; F5F0: D0 E6          '..'
        cmpb    #$1A                    ; F5F2: C1 1A          '..'
        bhi     ZF5F8                   ; F5F4: 22 02          '".'
        ldab    #$1A                    ; F5F6: C6 1A          '..'
ZF5F8   subb    #$14                    ; F5F8: C0 14          '..'
ZF5FA   ldx     #P1_DDR                 ; F5FA: CE 00 00       '...'
        abx                             ; F5FD: 3A             ':'
        pulb                            ; F5FE: 33             '3'
        pshb                            ; F5FF: 37             '7'
        cba                             ; F600: 11             '.'
        bcc     ZF607                   ; F601: 24 04          '$.'
        xgdx                            ; F603: 18             '.'
        tba                             ; F604: 17             '.'
        bra     ZF626                   ; F605: 20 1F          ' .'
ZF607   sba                             ; F607: 10             '.'
        psha                            ; F608: 36             '6'
        ldab    M00E4                   ; F609: D6 E4          '..'
        mul                             ; F60B: 3D             '='
        lsra                            ; F60C: 44             'D'
        lsra                            ; F60D: 44             'D'
        adca    #$00                    ; F60E: 89 00          '..'
        staa    M00E6                   ; F610: 97 E6          '..'
        clr     M00E5                   ; F612: 7F 00 E5       '...'
        pula                            ; F615: 32             '2'
        ldab    M00E3                   ; F616: D6 E3          '..'
        mul                             ; F618: 3D             '='
        lsrd                            ; F619: 04             '.'
        lsrd                            ; F61A: 04             '.'
        adcb    #$00                    ; F61B: C9 00          '..'
        addd    M00E5                   ; F61D: D3 E5          '..'
        xgdx                            ; F61F: 18             '.'
        abx                             ; F620: 3A             ':'
        xgdx                            ; F621: 18             '.'
        tsta                            ; F622: 4D             'M'
        bne     ZF62A                   ; F623: 26 05          '&.'
        tba                             ; F625: 17             '.'
ZF626   cmpa    M0094                   ; F626: 91 94          '..'
        bcs     ZF62C                   ; F628: 25 02          '%.'
ZF62A   ldaa    M0094                   ; F62A: 96 94          '..'
ZF62C   pulb                            ; F62C: 33             '3'
        tim     #$80,M00A8              ; F62D: 7B 80 A8       '{..'
        bne     ZF633                   ; F630: 26 01          '&.'
        rts                             ; F632: 39             '9'
ZF633   psha                            ; F633: 36             '6'
        ldx     M00E3                   ; F634: DE E3          '..'
        clra                            ; F636: 4F             'O'
        std     M00E3                   ; F637: DD E3          '..'
        ldd     #SCI_RMCR               ; F639: CC 00 10       '...'
        std     M00E5                   ; F63C: DD E5          '..'
        jsr     ZF6F8                   ; F63E: BD F6 F8       '...'
        ldab    M00E4                   ; F641: D6 E4          '..'
        stx     M00E3                   ; F643: DF E3          '..'
        ldx     #M00BF                  ; F645: CE 00 BF       '...'
        abx                             ; F648: 3A             ':'
        ldab    #$10                    ; F649: C6 10          '..'
        subb    M00E8                   ; F64B: D0 E8          '..'
        ldaa    M00E8                   ; F64D: 96 E8          '..'
        mul                             ; F64F: 3D             '='
        ldaa    $00,x                   ; F650: A6 00          '..'
        cpx     #M00BF                  ; F652: 8C 00 BF       '...'
        bne     ZF659                   ; F655: 26 02          '&.'
        ldaa    $01,x                   ; F657: A6 01          '..'
ZF659   suba    $01,x                   ; F659: A0 01          '..'
        cpx     #M00CD                  ; F65B: 8C 00 CD       '...'
        bcc     ZF664                   ; F65E: 24 04          '$.'
        adda    $03,x                   ; F660: AB 03          '..'
        suba    $02,x                   ; F662: A0 02          '..'
ZF664   staa    M00E5                   ; F664: 97 E5          '..'
        bpl     ZF669                   ; F666: 2A 01          '*.'
        nega                            ; F668: 40             '@'
ZF669   mul                             ; F669: 3D             '='
        lsrd                            ; F66A: 04             '.'
        lsrd                            ; F66B: 04             '.'
        lsrd                            ; F66C: 04             '.'
        adcb    #$00                    ; F66D: C9 00          '..'
        adca    #$00                    ; F66F: 89 00          '..'
        tst     M00E5                   ; F671: 7D 00 E5       '}..'
        bpl     ZF67B                   ; F674: 2A 05          '*.'
        coma                            ; F676: 43             'C'
        comb                            ; F677: 53             'S'
        addd    #P2_DDR                 ; F678: C3 00 01       '...'
ZF67B   std     M00E5                   ; F67B: DD E5          '..'
        ldaa    M00E8                   ; F67D: 96 E8          '..'
        ldab    $02,x                   ; F67F: E6 02          '..'
        cpx     #M00CE                  ; F681: 8C 00 CE       '...'
        bne     ZF688                   ; F684: 26 02          '&.'
        ldab    $01,x                   ; F686: E6 01          '..'
ZF688   subb    $01,x                   ; F688: E0 01          '..'
        stab    M00E7                   ; F68A: D7 E7          '..'
        bpl     ZF68F                   ; F68C: 2A 01          '*.'
        negb                            ; F68E: 50             'P'
ZF68F   mul                             ; F68F: 3D             '='
        asld                            ; F690: 05             '.'
        asld                            ; F691: 05             '.'
        asld                            ; F692: 05             '.'
        tst     M00E7                   ; F693: 7D 00 E7       '}..'
        bpl     ZF69D                   ; F696: 2A 05          '*.'
        coma                            ; F698: 43             'C'
        comb                            ; F699: 53             'S'
        addd    #P2_DDR                 ; F69A: C3 00 01       '...'
ZF69D   adda    $01,x                   ; F69D: AB 01          '..'
        subd    M00E5                   ; F69F: 93 E5          '..'
        tim     #$01,M00A1              ; F6A1: 7B 01 A1       '{..'
        bne     ZF6A8                   ; F6A4: 26 02          '&.'
        adda    M00AF                   ; F6A6: 9B AF          '..'
ZF6A8   staa    M00E5                   ; F6A8: 97 E5          '..'
        tsta                            ; F6AA: 4D             'M'
        bpl     ZF6B2                   ; F6AB: 2A 05          '*.'
        coma                            ; F6AD: 43             'C'
        comb                            ; F6AE: 53             'S'
        addd    #P2_DDR                 ; F6AF: C3 00 01       '...'
ZF6B2   staa    M00E6                   ; F6B2: 97 E6          '..'
        ldab    M00E4                   ; F6B4: D6 E4          '..'
        mul                             ; F6B6: 3D             '='
        std     M00E7                   ; F6B7: DD E7          '..'
        ldaa    M00E6                   ; F6B9: 96 E6          '..'
        ldab    M00E3                   ; F6BB: D6 E3          '..'
        addb    #$02                    ; F6BD: CB 02          '..'
        mul                             ; F6BF: 3D             '='
        addb    M00E7                   ; F6C0: DB E7          '..'
        adca    #$00                    ; F6C2: 89 00          '..'
        lsrd                            ; F6C4: 04             '.'
        lsrd                            ; F6C5: 04             '.'
        lsrd                            ; F6C6: 04             '.'
        lsrd                            ; F6C7: 04             '.'
        adcb    #$00                    ; F6C8: C9 00          '..'
        adca    #$00                    ; F6CA: 89 00          '..'
        tsta                            ; F6CC: 4D             'M'
        beq     ZF6D1                   ; F6CD: 27 02          ''.'
        ldab    #$FF                    ; F6CF: C6 FF          '..'
ZF6D1   pula                            ; F6D1: 32             '2'
        tst     M00E5                   ; F6D2: 7D 00 E5       '}..'
        bmi     ZF6E1                   ; F6D5: 2B 0A          '+.'
        aba                             ; F6D7: 1B             '.'
        bcs     ZF6DE                   ; F6D8: 25 04          '%.'
        cmpa    M0094                   ; F6DA: 91 94          '..'
        bcs     ZF6E0                   ; F6DC: 25 02          '%.'
ZF6DE   ldaa    M0094                   ; F6DE: 96 94          '..'
ZF6E0   rts                             ; F6E0: 39             '9'
ZF6E1   sba                             ; F6E1: 10             '.'
        bcc     ZF6E5                   ; F6E2: 24 01          '$.'
        clra                            ; F6E4: 4F             'O'
ZF6E5   tim     #$01,M00A1              ; F6E5: 7B 01 A1       '{..'
        beq     ZF6F1                   ; F6E8: 27 07          ''.'
        cmpa    #$06                    ; F6EA: 81 06          '..'
        bhi     ZF6F0                   ; F6EC: 22 02          '".'
        ldaa    #$06                    ; F6EE: 86 06          '..'
ZF6F0   rts                             ; F6F0: 39             '9'
ZF6F1   cmpa    M0096                   ; F6F1: 91 96          '..'
        bhi     ZF6F7                   ; F6F3: 22 02          '".'
        ldaa    M0096                   ; F6F5: 96 96          '..'
ZF6F7   rts                             ; F6F7: 39             '9'
ZF6F8   pshx                            ; F6F8: 3C             '<'
        ldx     #SCI_RMCR               ; F6F9: CE 00 10       '...'
        clr     M00E7                   ; F6FC: 7F 00 E7       '...'
        clr     M00E8                   ; F6FF: 7F 00 E8       '...'
ZF702   rol     M00E4                   ; F702: 79 00 E4       'y..'
        rol     M00E3                   ; F705: 79 00 E3       'y..'
        rol     M00E8                   ; F708: 79 00 E8       'y..'
        rol     M00E7                   ; F70B: 79 00 E7       'y..'
        ldd     M00E7                   ; F70E: DC E7          '..'
        subd    M00E5                   ; F710: 93 E5          '..'
        bcs     ZF719                   ; F712: 25 05          '%.'
        sec                             ; F714: 0D             '.'
        std     M00E7                   ; F715: DD E7          '..'
        bra     ZF71A                   ; F717: 20 01          ' .'
ZF719   clc                             ; F719: 0C             '.'
ZF71A   dex                             ; F71A: 09             '.'
        bne     ZF702                   ; F71B: 26 E5          '&.'
        rol     M00E4                   ; F71D: 79 00 E4       'y..'
        rol     M00E3                   ; F720: 79 00 E3       'y..'
        pulx                            ; F723: 38             '8'
        rts                             ; F724: 39             '9'
ZF725   ldab    M00A2                   ; F725: D6 A2          '..'
        andb    #$03                    ; F727: C4 03          '..'
        ldx     #MF08A                  ; F729: CE F0 8A       '...'
        abx                             ; F72C: 3A             ':'
        ldab    M0082                   ; F72D: D6 82          '..'
        tim     #$04,M00A2              ; F72F: 7B 04 A2       '{..'
        bne     ZF75E                   ; F732: 26 2A          '&*'
        cba                             ; F734: 11             '.'
        bhi     ZF73B                   ; F735: 22 04          '".'
        aim     #$CF,P1_DR              ; F737: 71 CF 02       'q..'
        rts                             ; F73A: 39             '9'
ZF73B   addb    $00,x                   ; F73B: EB 00          '..'
        cba                             ; F73D: 11             '.'
        bhi     ZF742                   ; F73E: 22 02          '".'
        bra     ZF745                   ; F740: 20 03          ' .'
ZF742   oim     #$10,P1_DR              ; F742: 72 10 02       'r..'
ZF745   ldab    M00A3                   ; F745: D6 A3          '..'
        andb    #$0F                    ; F747: C4 0F          '..'
        addb    #$03                    ; F749: CB 03          '..'
        aslb                            ; F74B: 58             'X'
        addb    M0082                   ; F74C: DB 82          '..'
        cba                             ; F74E: 11             '.'
        bhi     ZF755                   ; F74F: 22 04          '".'
        aim     #$DF,P1_DR              ; F751: 71 DF 02       'q..'
        rts                             ; F754: 39             '9'
ZF755   addb    $00,x                   ; F755: EB 00          '..'
        cba                             ; F757: 11             '.'
        bls     ZF75D                   ; F758: 23 03          '#.'
        oim     #$20,P1_DR              ; F75A: 72 20 02       'r .'
ZF75D   rts                             ; F75D: 39             '9'
ZF75E   tim     #$01,M00A2              ; F75E: 7B 01 A2       '{..'
        bne     ZF784                   ; F761: 26 21          '&!'
        cba                             ; F763: 11             '.'
        bne     ZF76A                   ; F764: 26 04          '&.'
        aim     #$CF,P1_DR              ; F766: 71 CF 02       'q..'
        rts                             ; F769: 39             '9'
ZF76A   bhi     ZF778                   ; F76A: 22 0C          '".'
        aim     #$EF,P1_DR              ; F76C: 71 EF 02       'q..'
        adda    #$03                    ; F76F: 8B 03          '..'
        cba                             ; F771: 11             '.'
        bcc     ZF777                   ; F772: 24 03          '$.'
        oim     #$20,P1_DR              ; F774: 72 20 02       'r .'
ZF777   rts                             ; F777: 39             '9'
ZF778   aim     #$DF,P1_DR              ; F778: 71 DF 02       'q..'
        addb    #$03                    ; F77B: CB 03          '..'
        cba                             ; F77D: 11             '.'
        bls     ZF783                   ; F77E: 23 03          '#.'
        oim     #$10,P1_DR              ; F780: 72 10 02       'r..'
ZF783   rts                             ; F783: 39             '9'
ZF784   aim     #$DF,P1_DR              ; F784: 71 DF 02       'q..'
        ldab    M00A3                   ; F787: D6 A3          '..'
        andb    #$0F                    ; F789: C4 0F          '..'
        addb    #$03                    ; F78B: CB 03          '..'
        aslb                            ; F78D: 58             'X'
        aslb                            ; F78E: 58             'X'
        tim     #$02,P3_DR              ; F78F: 7B 02 06       '{..'
        bne     ZF7A3                   ; F792: 26 0F          '&.'
        adda    #$10                    ; F794: 8B 10          '..'
        suba    M0082                   ; F796: 90 82          '..'
        bcc     ZF79B                   ; F798: 24 01          '$.'
        clra                            ; F79A: 4F             'O'
ZF79B   ldx     #M0380                  ; F79B: CE 03 80       '...'
        ldab    #$1C                    ; F79E: C6 1C          '..'
        mul                             ; F7A0: 3D             '='
        bra     ZF7BC                   ; F7A1: 20 19          ' .'
ZF7A3   suba    M0082                   ; F7A3: 90 82          '..'
        bcc     ZF7AD                   ; F7A5: 24 06          '$.'
        aba                             ; F7A7: 1B             '.'
        bcs     ZF7B2                   ; F7A8: 25 08          '%.'
        clra                            ; F7AA: 4F             'O'
        bra     ZF7B2                   ; F7AB: 20 05          ' .'
ZF7AD   aba                             ; F7AD: 1B             '.'
        bcc     ZF7B2                   ; F7AE: 24 02          '$.'
        ldaa    #$FF                    ; F7B0: 86 FF          '..'
ZF7B2   aslb                            ; F7B2: 58             'X'
        ldx     #P1_DDR                 ; F7B3: CE 00 00       '...'
        abx                             ; F7B6: 3A             ':'
        tab                             ; F7B7: 16             '.'
        clra                            ; F7B8: 4F             'O'
        oim     #$10,M00E2              ; F7B9: 72 10 E2       'r..'
ZF7BC   tim     #$02,M00E0              ; F7BC: 7B 02 E0       '{..'
        bne     ZF7D4                   ; F7BF: 26 13          '&.'
        oim     #$20,P1_DR              ; F7C1: 72 20 02       'r .'
        oim     #$06,M00E0              ; F7C4: 72 06 E0       'r..'
        stx     M00DA                   ; F7C7: DF DA          '..'
        std     M00DC                   ; F7C9: DD DC          '..'
        aim     #$DF,P1_DR              ; F7CB: 71 DF 02       'q..'
        tstb                            ; F7CE: 5D             ']'
        bne     ZF7D4                   ; F7CF: 26 03          '&.'
        aim     #$FB,M00E0              ; F7D1: 71 FB E0       'q..'
ZF7D4   tim     #$04,M00E0              ; F7D4: 7B 04 E0       '{..'
        bne     ZF7DD                   ; F7D7: 26 04          '&.'
        aim     #$EF,P1_DR              ; F7D9: 71 EF 02       'q..'
        rts                             ; F7DC: 39             '9'
ZF7DD   oim     #$10,P1_DR              ; F7DD: 72 10 02       'r..'
        rts                             ; F7E0: 39             '9'
ZF7E1   tim     #$04,M00E1              ; F7E1: 7B 04 E1       '{..'
        beq     ZF7EB                   ; F7E4: 27 05          ''.'
        oim     #$80,P1_DR              ; F7E6: 72 80 02       'r..'
        bra     ZF828                   ; F7E9: 20 3D          ' ='
ZF7EB   aim     #$7F,P1_DR              ; F7EB: 71 7F 02       'q..'
        ldaa    M0098                   ; F7EE: 96 98          '..'
        tab                             ; F7F0: 16             '.'
        anda    #$0F                    ; F7F1: 84 0F          '..'
        adda    #$28                    ; F7F3: 8B 28          '.('
        asla                            ; F7F5: 48             'H'
        asla                            ; F7F6: 48             'H'
        andb    #$F0                    ; F7F7: C4 F0          '..'
        lsrb                            ; F7F9: 54             'T'
        lsrb                            ; F7FA: 54             'T'
        tim     #$80,M00A8              ; F7FB: 7B 80 A8       '{..'
        bne     ZF80A                   ; F7FE: 26 0A          '&.'
        tim     #$08,M00E1              ; F800: 7B 08 E1       '{..'
        bne     ZF808                   ; F803: 26 03          '&.'
        sba                             ; F805: 10             '.'
        bra     ZF80A                   ; F806: 20 02          ' .'
ZF808   ldaa    #$84                    ; F808: 86 84          '..'
ZF80A   tim     #$10,M00E1              ; F80A: 7B 10 E1       '{..'
        bne     ZF818                   ; F80D: 26 09          '&.'
        cmpa    M0081                   ; F80F: 91 81          '..'
        bhi     ZF821                   ; F811: 22 0E          '".'
        oim     #$10,M00E1              ; F813: 72 10 E1       'r..'
        bra     ZF828                   ; F816: 20 10          ' .'
ZF818   suba    #$04                    ; F818: 80 04          '..'
        cmpa    M0081                   ; F81A: 91 81          '..'
        bls     ZF828                   ; F81C: 23 0A          '#.'
        aim     #$EF,M00E1              ; F81E: 71 EF E1       'q..'
ZF821   aim     #$EF,M00E0              ; F821: 71 EF E0       'q..'
        aim     #$BF,P1_DR              ; F824: 71 BF 02       'q..'
        rts                             ; F827: 39             '9'
ZF828   tim     #$10,M00E0              ; F828: 7B 10 E0       '{..'
        bne     ZF839                   ; F82B: 26 0C          '&.'
        oim     #$10,M00E0              ; F82D: 72 10 E0       'r..'
        ldx     #M2200                  ; F830: CE 22 00       '.".'
        stx     M00DE                   ; F833: DF DE          '..'
        oim     #$08,M00E0              ; F835: 72 08 E0       'r..'
        rts                             ; F838: 39             '9'
ZF839   tim     #$01,M00EA              ; F839: 7B 01 EA       '{..'
        beq     ZF841                   ; F83C: 27 03          ''.'
        aim     #$F7,M00E0              ; F83E: 71 F7 E0       'q..'
ZF841   tim     #$08,M00E0              ; F841: 7B 08 E0       '{..'
        bne     ZF84D                   ; F844: 26 07          '&.'
        ldx     M00A6                   ; F846: DE A6          '..'
        cpx     #M1000                  ; F848: 8C 10 00       '...'
        bne     ZF851                   ; F84B: 26 04          '&.'
ZF84D   aim     #$BF,P1_DR              ; F84D: 71 BF 02       'q..'
        rts                             ; F850: 39             '9'
ZF851   oim     #$40,P1_DR              ; F851: 72 40 02       'r@.'
        rts                             ; F854: 39             '9'
ZF855   tim     #$01,SCI_TRCSR          ; F855: 7B 01 11       '{..'
        bne     ZF855                   ; F858: 26 FB          '&.'
        aim     #$EF,SCI_TRCSR          ; F85A: 71 EF 11       'q..'
        ldaa    #$18                    ; F85D: 86 18          '..'
        staa    SCI_TDR                 ; F85F: 97 13          '..'
        staa    M00D0                   ; F861: 97 D0          '..'
        jsr     ZF898                   ; F863: BD F8 98       '...'
ZF866   tim     #$20,SCI_TRCSR          ; F866: 7B 20 11       '{ .'
        beq     ZF866                   ; F869: 27 FB          ''.'
        ldaa    #$80                    ; F86B: 86 80          '..'
        staa    SCI_TDR                 ; F86D: 97 13          '..'
        eora    M00D0                   ; F86F: 98 D0          '..'
        staa    M00D0                   ; F871: 97 D0          '..'
        ldx     #M00A5                  ; F873: CE 00 A5       '...'
ZF876   tim     #$20,SCI_TRCSR          ; F876: 7B 20 11       '{ .'
        beq     ZF876                   ; F879: 27 FB          ''.'
        ldaa    $00,x                   ; F87B: A6 00          '..'
        staa    SCI_TDR                 ; F87D: 97 13          '..'
        eora    M00D0                   ; F87F: 98 D0          '..'
        staa    M00D0                   ; F881: 97 D0          '..'
        inx                             ; F883: 08             '.'
        cpx     #M00A7                  ; F884: 8C 00 A7       '...'
        bls     ZF876                   ; F887: 23 ED          '#.'
        jsr     ZF9C4                   ; F889: BD F9 C4       '...'
ZF88C   tim     #$20,SCI_TRCSR          ; F88C: 7B 20 11       '{ .'
        beq     ZF88C                   ; F88F: 27 FB          ''.'
        oim     #$10,SCI_TRCSR          ; F891: 72 10 11       'r..'
        aim     #$7F,M00E0              ; F894: 71 7F E0       'q..'
        rts                             ; F897: 39             '9'
ZF898   ldd     #M0300                  ; F898: CC 03 00       '...'
        std     TMP_0                   ; F89B: DD D2          '..'
        ldx     #M00E3                  ; F89D: CE 00 E3       '...'
        oim     #$10,Bitfield_mystery   ; F8A0: 72 10 D4       'r..'
        bsr     startup_p4_bitflipping_orchestrator ; F8A3: 8D 4F          '.O'
        ldaa    M00E5                   ; F8A5: 96 E5          '..'
        lsra                            ; F8A7: 44             'D'
        lsra                            ; F8A8: 44             'D'
        lsra                            ; F8A9: 44             'D'
        lsra                            ; F8AA: 44             'D'
        ldab    #$06                    ; F8AB: C6 06          '..'
        mul                             ; F8AD: 3D             '='
        ldaa    M00E5                   ; F8AE: 96 E5          '..'
        sba                             ; F8B0: 10             '.'
        ldx     #MF057                  ; F8B1: CE F0 57       '..W'
        ldab    M00E6                   ; F8B4: D6 E6          '..'
        abx                             ; F8B6: 3A             ':'
        adda    $00,x                   ; F8B7: AB 00          '..'
ZF8B9   cmpa    #$07                    ; F8B9: 81 07          '..'
        bcs     ZF8C1                   ; F8BB: 25 04          '%.'
        suba    #$07                    ; F8BD: 80 07          '..'
        bra     ZF8B9                   ; F8BF: 20 F8          ' .'
ZF8C1   staa    M00A5                   ; F8C1: 97 A5          '..'
        ldd     M00E3                   ; F8C3: DC E3          '..'
        std     M00A6                   ; F8C5: DD A6          '..'
ZF8C7   oim     #$10,Bitfield_mystery   ; F8C7: 72 10 D4       'r..'
        tim     #$80,M00A5              ; F8CA: 7B 80 A5       '{..'
        beq     ZF8DA                   ; F8CD: 27 0B          ''.'
        ldaa    #$20                    ; F8CF: 86 20          '. '
        staa    TMP_1                   ; F8D1: 97 D3          '..'
        aim     #$7F,M00A5              ; F8D3: 71 7F A5       'q..'
        bsr     p4_bitflippy_1          ; F8D6: 8D 3D          '.='
        bsr     p4_bitflippy_5          ; F8D8: 8D 71          '.q'
ZF8DA   clra                            ; F8DA: 4F             'O'
        staa    TMP_1                   ; F8DB: 97 D3          '..'
        bsr     p4_bitflippy_1          ; F8DD: 8D 36          '.6'
        ldaa    M00A6                   ; F8DF: 96 A6          '..'
        jsr     p4_bitflippy_2          ; F8E1: BD F9 5B       '..['
        ldaa    M00A7                   ; F8E4: 96 A7          '..'
        jsr     p4_bitflippy_2          ; F8E6: BD F9 5B       '..['
        ldaa    M00A5                   ; F8E9: 96 A5          '..'
        bsr     p4_bitflippy_2          ; F8EB: 8D 6E          '.n'
        ldaa    #$01                    ; F8ED: 86 01          '..'
        bsr     p4_bitflippy_2          ; F8EF: 8D 6A          '.j'
        bsr     p4_bitflippy_5          ; F8F1: 8D 58          '.X'
        rts                             ; F8F3: 39             '9'

; Parameters: X register, TMP_0 (00D2)
startup_p4_bitflipping_orchestrator
        bsr     p4_bitflippy_1          ; F8F4: 8D 1F          '..'
        bsr     p4_bitflippy_3          ; F8F6: 8D 3C          '.<'
ZF8F8   jsr     p4_bitflippy_4          ; F8F8: BD F9 88       '...'
        staa    $00,x                   ; F8FB: A7 00          '..'
        inx                             ; F8FD: 08             '.'
        dec     TMP_0                   ; F8FE: 7A 00 D2       'z..'
        bpl     ZF8F8                   ; F901: 2A F5          '*.'
        bsr     p4_bitflippy_5          ; F903: 8D 46          '.F'
        rts                             ; F905: 39             '9'

ZF906   bsr     p4_bitflippy_1          ; F906: 8D 0D          '..'
ZF908   ldaa    $00,x                   ; F908: A6 00          '..'
        bsr     p4_bitflippy_2          ; F90A: 8D 4F          '.O'
        inx                             ; F90C: 08             '.'
        dec     TMP_0                   ; F90D: 7A 00 D2       'z..'
        bpl     ZF908                   ; F910: 2A F6          '*.'
        bsr     p4_bitflippy_5          ; F912: 8D 37          '.7'
        rts                             ; F914: 39             '9'

; Parameters: TMP_1 (00D3), used as A parameter for p4_bitflippy_2
p4_bitflippy_1
        oim     #$20,P4_DR              ; F915: 72 20 07       'r .'
        nop                             ; F918: 01             '.'
        oim     #$40,P4_DR              ; F919: 72 40 07       'r@.'
        nop                             ; F91C: 01             '.'
        oim     #$80,P4_DR              ; F91D: 72 80 07       'r..'
        nop                             ; F920: 01             '.'
        aim     #$BF,P4_DR              ; F921: 71 BF 07       'q..'
        ldaa    #$AE                    ; F924: 86 AE          '..'
        tim     #$10,Bitfield_mystery   ; F926: 7B 10 D4       '{..'
        beq     ZF92D                   ; F929: 27 02          ''.'
        ldaa    #$D0                    ; F92B: 86 D0          '..'
ZF92D   bsr     p4_bitflippy_2          ; F92D: 8D 2C          '.,'
        ldaa    TMP_1                   ; F92F: 96 D3          '..'
        bsr     p4_bitflippy_2          ; F931: 8D 28          '.('
        rts                             ; F933: 39             '9'

; Parameters: (none)
p4_bitflippy_3
        oim     #$40,P4_DR              ; F934: 72 40 07       'r@.'
        nop                             ; F937: 01             '.'
        oim     #$80,P4_DR              ; F938: 72 80 07       'r..'
        nop                             ; F93B: 01             '.'
        aim     #$BF,P4_DR              ; F93C: 71 BF 07       'q..'
        ldaa    #$AF                    ; F93F: 86 AF          '..'
        tim     #$10,Bitfield_mystery   ; F941: 7B 10 D4       '{..'
        beq     ZF948                   ; F944: 27 02          ''.'
        ldaa    #$D1                    ; F946: 86 D1          '..'
ZF948   bsr     p4_bitflippy_2          ; F948: 8D 11          '..'
        rts                             ; F94A: 39             '9'

; Parameters: (none)
p4_bitflippy_5
        aim     #$BF,P4_DR              ; F94B: 71 BF 07       'q..'
        nop                             ; F94E: 01             '.'
        oim     #$80,P4_DR              ; F94F: 72 80 07       'r..'
        nop                             ; F952: 01             '.'
        oim     #$40,P4_DR              ; F953: 72 40 07       'r@.'
        nop                             ; F956: 01             '.'
        aim     #$DF,P4_DR              ; F957: 71 DF 07       'q..'
        rts                             ; F95A: 39             '9'

; Parameters: A register. Bits set/clear changes whether P4.6 is set.
p4_bitflippy_2
        ldab    #$08                    ; F95B: C6 08          '..'
ZF95D   aim     #$7F,P4_DR              ; F95D: 71 7F 07       'q..'
        rola                            ; F960: 49             'I'
        bcc     ZF968                   ; F961: 24 05          '$.'
        oim     #$40,P4_DR              ; F963: 72 40 07       'r@.'
        bra     ZF96B                   ; F966: 20 03          ' .'
ZF968   aim     #$BF,P4_DR              ; F968: 71 BF 07       'q..'
ZF96B   nop                             ; F96B: 01             '.'
        oim     #$80,P4_DR              ; F96C: 72 80 07       'r..'
        decb                            ; F96F: 5A             'Z'
        bne     ZF95D                   ; F970: 26 EB          '&.'
        aim     #$7F,P4_DR              ; F972: 71 7F 07       'q..'
        nop                             ; F975: 01             '.'
        ldab    #$B0                    ; F976: C6 B0          '..'
        stab    P4_DDR                  ; F978: D7 05          '..'
        nop                             ; F97A: 01             '.'
        oim     #$80,P4_DR              ; F97B: 72 80 07       'r..'
        nop                             ; F97E: 01             '.'
        aim     #$7F,P4_DR              ; F97F: 71 7F 07       'q..'
        nop                             ; F982: 01             '.'
        ldab    #$F0                    ; F983: C6 F0          '..'
        stab    P4_DDR                  ; F985: D7 05          '..'
        rts                             ; F987: 39             '9'

; Parameters: A register, TMP_0 (if nonzero some extra P4 bitflipping)
p4_bitflippy_4
        ldab    #$B0                    ; F988: C6 B0          '..'
        stab    P4_DDR                  ; F98A: D7 05          '..'
        ldab    #$08                    ; F98C: C6 08          '..'
ZF98E   asla                            ; F98E: 48             'H'
        oim     #$80,P4_DR              ; F98F: 72 80 07       'r..'
        nop                             ; F992: 01             '.'
        tim     #$40,P4_DR              ; F993: 7B 40 07       '{@.'
        beq     ZF999                   ; F996: 27 01          ''.'
        inca                            ; F998: 4C             'L'
ZF999   aim     #$7F,P4_DR              ; F999: 71 7F 07       'q..'
        decb                            ; F99C: 5A             'Z'
        bne     ZF98E                   ; F99D: 26 EF          '&.'
        ldab    #$F0                    ; F99F: C6 F0          '..'
        stab    P4_DDR                  ; F9A1: D7 05          '..'
        tst     TMP_0                   ; F9A3: 7D 00 D2       '}..'
        beq     ZF9B8                   ; F9A6: 27 10          ''.'
        aim     #$BF,P4_DR              ; F9A8: 71 BF 07       'q..'
        nop                             ; F9AB: 01             '.'
        oim     #$80,P4_DR              ; F9AC: 72 80 07       'r..'
        nop                             ; F9AF: 01             '.'
        aim     #$7F,P4_DR              ; F9B0: 71 7F 07       'q..'
        nop                             ; F9B3: 01             '.'
        oim     #$40,P4_DR              ; F9B4: 72 40 07       'r@.'
        rts                             ; F9B7: 39             '9'
ZF9B8   oim     #$40,P4_DR              ; F9B8: 72 40 07       'r@.'
        nop                             ; F9BB: 01             '.'
        oim     #$80,P4_DR              ; F9BC: 72 80 07       'r..'
        nop                             ; F9BF: 01             '.'
        aim     #$7F,P4_DR              ; F9C0: 71 7F 07       'q..'
        rts                             ; F9C3: 39             '9'
ZF9C4   ldd     #M5300                  ; F9C4: CC 53 00       '.S.'
        std     TMP_0                   ; F9C7: DD D2          '..'
        aim     #$EF,Bitfield_mystery   ; F9C9: 71 EF D4       'q..'
        ldaa    #$FF                    ; F9CC: 86 FF          '..'
        staa    M00BB                   ; F9CE: 97 BB          '..'
        staa    M00B8                   ; F9D0: 97 B8          '..'
        staa    M00BF                   ; F9D2: 97 BF          '..'
        aim     #$FE,M00E1              ; F9D4: 71 FE E1       'q..'
        jsr     p4_bitflippy_1          ; F9D7: BD F9 15       '...'
        jsr     p4_bitflippy_3          ; F9DA: BD F9 34       '..4'
ZF9DD   ldab    M00A5                   ; F9DD: D6 A5          '..'
        stab    M00B3                   ; F9DF: D7 B3          '..'
        clr     M00B4                   ; F9E1: 7F 00 B4       '...'
        jsr     ZFAF6                   ; F9E4: BD FA F6       '...'
        ldab    M00B5                   ; F9E7: D6 B5          '..'
        andb    #$0F                    ; F9E9: C4 0F          '..'
        cmpb    #$0A                    ; F9EB: C1 0A          '..'
        bhi     ZFA42                   ; F9ED: 22 53          '"S'
        ldd     M00A6                   ; F9EF: DC A6          '..'
        subd    M00B6                   ; F9F1: 93 B6          '..'
        bmi     ZFA09                   ; F9F3: 2B 14          '+.'
ZF9F5   ldab    M00B3                   ; F9F5: D6 B3          '..'
        ldx     #MF079                  ; F9F7: CE F0 79       '..y'
        abx                             ; F9FA: 3A             ':'
        ldaa    $00,x                   ; F9FB: A6 00          '..'
        ldab    M00B5                   ; F9FD: D6 B5          '..'
        andb    #$0F                    ; F9FF: C4 0F          '..'
        ldx     #MF079                  ; FA01: CE F0 79       '..y'
        abx                             ; FA04: 3A             ':'
        anda    $00,x                   ; FA05: A4 00          '..'
        bne     ZFA19                   ; FA07: 26 10          '&.'
ZFA09   ldab    M00B3                   ; FA09: D6 B3          '..'
        inc     M00B4                   ; FA0B: 7C 00 B4       '|..'
        decb                            ; FA0E: 5A             'Z'
        bpl     ZFA13                   ; FA0F: 2A 02          '*.'
        ldab    #$06                    ; FA11: C6 06          '..'
ZFA13   stab    M00B3                   ; FA13: D7 B3          '..'
        cmpb    M00A5                   ; FA15: D1 A5          '..'
        bne     ZF9F5                   ; FA17: 26 DC          '&.'
ZFA19   ldaa    M00B4                   ; FA19: 96 B4          '..'
        cmpa    M00BB                   ; FA1B: 91 BB          '..'
        bhi     ZFA42                   ; FA1D: 22 23          '"#'
        bcs     ZFA36                   ; FA1F: 25 15          '%.'
        ldd     M00B6                   ; FA21: DC B6          '..'
        subd    M00B9                   ; FA23: 93 B9          '..'
        beq     ZFA2B                   ; FA25: 27 04          ''.'
        bmi     ZFA42                   ; FA27: 2B 19          '+.'
        bra     ZFA36                   ; FA29: 20 0B          ' .'
ZFA2B   ldaa    M00B5                   ; FA2B: 96 B5          '..'
        anda    #$0F                    ; FA2D: 84 0F          '..'
        ldab    M00B8                   ; FA2F: D6 B8          '..'
        andb    #$0F                    ; FA31: C4 0F          '..'
        cba                             ; FA33: 11             '.'
        bcc     ZFA42                   ; FA34: 24 0C          '$.'
ZFA36   ldaa    M00B4                   ; FA36: 96 B4          '..'
        staa    M00BB                   ; FA38: 97 BB          '..'
        ldaa    M00B5                   ; FA3A: 96 B5          '..'
        staa    M00B8                   ; FA3C: 97 B8          '..'
        ldd     M00B6                   ; FA3E: DC B6          '..'
        std     M00B9                   ; FA40: DD B9          '..'
ZFA42   clr     M00B4                   ; FA42: 7F 00 B4       '...'
        ldaa    M00A5                   ; FA45: 96 A5          '..'
        staa    M00B3                   ; FA47: 97 B3          '..'
        tim     #$80,M00B5              ; FA49: 7B 80 B5       '{..'
        beq     ZFAA4                   ; FA4C: 27 56          ''V'
        ldab    M00B5                   ; FA4E: D6 B5          '..'
        andb    #$0F                    ; FA50: C4 0F          '..'
        cmpb    #$0A                    ; FA52: C1 0A          '..'
        bhi     ZFAA4                   ; FA54: 22 4E          '"N'
        ldx     #MF079                  ; FA56: CE F0 79       '..y'
        abx                             ; FA59: 3A             ':'
        ldd     M00A6                   ; FA5A: DC A6          '..'
        subd    M00B6                   ; FA5C: 93 B6          '..'
        bpl     ZFA62                   ; FA5E: 2A 02          '*.'
        bra     ZFA71                   ; FA60: 20 0F          ' .'
ZFA62   inc     M00B4                   ; FA62: 7C 00 B4       '|..'
        inc     M00B3                   ; FA65: 7C 00 B3       '|..'
        ldaa    M00B3                   ; FA68: 96 B3          '..'
        cmpa    #$06                    ; FA6A: 81 06          '..'
        bls     ZFA71                   ; FA6C: 23 03          '#.'
        clr     M00B3                   ; FA6E: 7F 00 B3       '...'
ZFA71   ldab    M00B3                   ; FA71: D6 B3          '..'
        ldaa    $00,x                   ; FA73: A6 00          '..'
        ldx     #MF079                  ; FA75: CE F0 79       '..y'
        abx                             ; FA78: 3A             ':'
        anda    $00,x                   ; FA79: A4 00          '..'
        beq     ZFAA4                   ; FA7B: 27 27          ''''
        ldaa    M00B4                   ; FA7D: 96 B4          '..'
        cmpa    M00BF                   ; FA7F: 91 BF          '..'
        bhi     ZFAA4                   ; FA81: 22 21          '"!'
        bcs     ZFA95                   ; FA83: 25 10          '%.'
        ldd     M00B6                   ; FA85: DC B6          '..'
        subd    M00BD                   ; FA87: 93 BD          '..'
        beq     ZFA8F                   ; FA89: 27 04          ''.'
        bpl     ZFAA4                   ; FA8B: 2A 17          '*.'
        bra     ZFA95                   ; FA8D: 20 06          ' .'
ZFA8F   ldaa    M00B5                   ; FA8F: 96 B5          '..'
        cmpa    M00BC                   ; FA91: 91 BC          '..'
        bcc     ZFAA4                   ; FA93: 24 0F          '$.'
ZFA95   ldaa    M00B4                   ; FA95: 96 B4          '..'
        staa    M00BF                   ; FA97: 97 BF          '..'
        ldaa    M00B5                   ; FA99: 96 B5          '..'
        staa    M00BC                   ; FA9B: 97 BC          '..'
        ldd     M00B6                   ; FA9D: DC B6          '..'
        std     M00BD                   ; FA9F: DD BD          '..'
        oim     #$01,M00E1              ; FAA1: 72 01 E1       'r..'
ZFAA4   dec     TMP_0                   ; FAA4: 7A 00 D2       'z..'
        bmi     ZFAAC                   ; FAA7: 2B 03          '+.'
        jmp     ZF9DD                   ; FAA9: 7E F9 DD       '~..'
ZFAAC   jsr     p4_bitflippy_5          ; FAAC: BD F9 4B       '..K'
        tim     #$01,M00E1              ; FAAF: 7B 01 E1       '{..'
        beq     ZFAF5                   ; FAB2: 27 41          ''A'
        ldd     #M5300                  ; FAB4: CC 53 00       '.S.'
        std     TMP_0                   ; FAB7: DD D2          '..'
        jsr     p4_bitflippy_1          ; FAB9: BD F9 15       '...'
        jsr     p4_bitflippy_3          ; FABC: BD F9 34       '..4'
ZFABF   bsr     ZFAF6                   ; FABF: 8D 35          '.5'
        tim     #$80,M00B5              ; FAC1: 7B 80 B5       '{..'
        bne     ZFAED                   ; FAC4: 26 27          '&''
        ldd     M00B6                   ; FAC6: DC B6          '..'
        subd    M00BD                   ; FAC8: 93 BD          '..'
        bne     ZFAED                   ; FACA: 26 21          '&!'
        ldab    M00B5                   ; FACC: D6 B5          '..'
        anda    #$0F                    ; FACE: 84 0F          '..'
        ldx     #MF079                  ; FAD0: CE F0 79       '..y'
        abx                             ; FAD3: 3A             ':'
        ldaa    $00,x                   ; FAD4: A6 00          '..'
        ldab    M00A5                   ; FAD6: D6 A5          '..'
        addb    M00BF                   ; FAD8: DB BF          '..'
        ldx     #MF079                  ; FADA: CE F0 79       '..y'
        abx                             ; FADD: 3A             ':'
        anda    $00,x                   ; FADE: A4 00          '..'
        beq     ZFAED                   ; FAE0: 27 0B          ''.'
        ldab    M00BC                   ; FAE2: D6 BC          '..'
        andb    #$0F                    ; FAE4: C4 0F          '..'
        cmpb    M00B5                   ; FAE6: D1 B5          '..'
        bcs     ZFAED                   ; FAE8: 25 03          '%.'
        aim     #$FE,M00E1              ; FAEA: 71 FE E1       'q..'
ZFAED   dec     TMP_0                   ; FAED: 7A 00 D2       'z..'
        bpl     ZFABF                   ; FAF0: 2A CD          '*.'
        jsr     p4_bitflippy_5          ; FAF2: BD F9 4B       '..K'
ZFAF5   rts                             ; FAF5: 39             '9'
ZFAF6   jsr     p4_bitflippy_4          ; FAF6: BD F9 88       '...'
        staa    M00B5                   ; FAF9: 97 B5          '..'
        dec     TMP_0                   ; FAFB: 7A 00 D2       'z..'
        jsr     p4_bitflippy_4          ; FAFE: BD F9 88       '...'
        staa    M00B6                   ; FB01: 97 B6          '..'
        dec     TMP_0                   ; FB03: 7A 00 D2       'z..'
        jsr     p4_bitflippy_4          ; FB06: BD F9 88       '...'
        staa    M00B7                   ; FB09: 97 B7          '..'
        rts                             ; FB0B: 39             '9'
ZFB0C   clrb                            ; FB0C: 5F             '_'
        tim     #$40,P3_DR              ; FB0D: 7B 40 06       '{@.'
        beq     ZFB1E                   ; FB10: 27 0C          ''.'
        ldab    P4_DR                   ; FB12: D6 07          '..'
        comb                            ; FB14: 53             'S'
        andb    #$0F                    ; FB15: C4 0F          '..'
        incb                            ; FB17: 5C             '\'
        cmpb    #$07                    ; FB18: C1 07          '..'
        bcs     ZFB1E                   ; FB1A: 25 02          '%.'
        ldab    #$07                    ; FB1C: C6 07          '..'
ZFB1E   rts                             ; FB1E: 39             '9'
ZFB1F   ldaa    P1_DR                   ; FB1F: 96 02          '..'
        anda    #$F0                    ; FB21: 84 F0          '..'
        lsra                            ; FB23: 44             'D'
        lsra                            ; FB24: 44             'D'
        tim     #$10,M00E2              ; FB25: 7B 10 E2       '{..'
        beq     ZFB43                   ; FB28: 27 19          ''.'
        anda    #$FB                    ; FB2A: 84 FB          '..'
        ldab    M00A8                   ; FB2C: D6 A8          '..'
        andb    #$04                    ; FB2E: C4 04          '..'
        aba                             ; FB30: 1B             '.'
        ldab    M00D6                   ; FB31: D6 D6          '..'
        cmpb    M0082                   ; FB33: D1 82          '..'
        bhi     ZFB3B                   ; FB35: 22 04          '".'
        anda    #$FB                    ; FB37: 84 FB          '..'
        bra     ZFB43                   ; FB39: 20 08          ' .'
ZFB3B   subb    #$02                    ; FB3B: C0 02          '..'
        cmpb    M0082                   ; FB3D: D1 82          '..'
        bls     ZFB43                   ; FB3F: 23 02          '#.'
        oraa    #$04                    ; FB41: 8A 04          '..'
ZFB43   ldab    M00A2                   ; FB43: D6 A2          '..'
        andb    #$07                    ; FB45: C4 07          '..'
        cmpb    #$04                    ; FB47: C1 04          '..'
        bne     ZFB4D                   ; FB49: 26 02          '&.'
        adda    #$40                    ; FB4B: 8B 40          '.@'
ZFB4D   ldab    M00B8                   ; FB4D: D6 B8          '..'
        andb    #$80                    ; FB4F: C4 80          '..'
        aba                             ; FB51: 1B             '.'
        tst     M00A9                   ; FB52: 7D 00 A9       '}..'
        beq     ZFB5B                   ; FB55: 27 04          ''.'
        anda    #$7C                    ; FB57: 84 7C          '.|'
        adda    #$02                    ; FB59: 8B 02          '..'
ZFB5B   tim     #$80,M00AA              ; FB5B: 7B 80 AA       '{..'
        beq     ZFB92                   ; FB5E: 27 32          ''2'
        tim     #$80,M00E2              ; FB60: 7B 80 E2       '{..'
        bne     ZFB72                   ; FB63: 26 0D          '&.'
        oim     #$80,M00E2              ; FB65: 72 80 E2       'r..'
        psha                            ; FB68: 36             '6'
        ldd     M00A6                   ; FB69: DC A6          '..'
        std     M00B1                   ; FB6B: DD B1          '..'
        pula                            ; FB6D: 32             '2'
        ldab    M00A5                   ; FB6E: D6 A5          '..'
        stab    M00B0                   ; FB70: D7 B0          '..'
ZFB72   ldab    M00B0                   ; FB72: D6 B0          '..'
        cmpb    M00A5                   ; FB74: D1 A5          '..'
        beq     ZFB7C                   ; FB76: 27 04          ''.'
        orab    #$80                    ; FB78: CA 80          '..'
        stab    M00B0                   ; FB7A: D7 B0          '..'
ZFB7C   tst     M00BB                   ; FB7C: 7D 00 BB       '}..'
        bne     ZFB97                   ; FB7F: 26 16          '&.'
        ldab    M00B0                   ; FB81: D6 B0          '..'
        cmpb    M00A5                   ; FB83: D1 A5          '..'
        bne     ZFB8F                   ; FB85: 26 08          '&.'
        psha                            ; FB87: 36             '6'
        ldd     M00B1                   ; FB88: DC B1          '..'
        subd    M00B9                   ; FB8A: 93 B9          '..'
        pula                            ; FB8C: 32             '2'
        bpl     ZFB97                   ; FB8D: 2A 08          '*.'
ZFB8F   aim     #$7F,M00AA              ; FB8F: 71 7F AA       'q..'
ZFB92   aim     #$7F,M00E2              ; FB92: 71 7F E2       'q..'
        bra     ZFB9B                   ; FB95: 20 04          ' .'
ZFB97   oraa    #$03                    ; FB97: 8A 03          '..'
        adda    #$80                    ; FB99: 8B 80          '..'
ZFB9B   tim     #$08,M00A1              ; FB9B: 7B 08 A1       '{..'
        beq     ZFBCE                   ; FB9E: 27 2E          ''.'
        cmpa    #$7F                    ; FBA0: 81 7F          '..'
        bls     ZFBAE                   ; FBA2: 23 0A          '#.'
        tim     #$02,M00E1              ; FBA4: 7B 02 E1       '{..'
        beq     ZFBCE                   ; FBA7: 27 25          ''%'
        oim     #$01,M00E2              ; FBA9: 72 01 E2       'r..'
        bra     ZFBCE                   ; FBAC: 20 20          '  '
ZFBAE   tim     #$01,M00E1              ; FBAE: 7B 01 E1       '{..'
        beq     ZFBCE                   ; FBB1: 27 1B          ''.'
        ldab    M00BF                   ; FBB3: D6 BF          '..'
        cmpb    M00A9                   ; FBB5: D1 A9          '..'
        bcs     ZFBCE                   ; FBB7: 25 15          '%.'
        oim     #$08,M00AA              ; FBB9: 72 08 AA       'r..'
        tim     #$02,M00E1              ; FBBC: 7B 02 E1       '{..'
        beq     ZFBC5                   ; FBBF: 27 04          ''.'
        oraa    #$80                    ; FBC1: 8A 80          '..'
        bra     ZFBD7                   ; FBC3: 20 12          ' .'
ZFBC5   tim     #$04,M00E2              ; FBC5: 7B 04 E2       '{..'
        beq     ZFBD7                   ; FBC8: 27 0D          ''.'
        oraa    #$80                    ; FBCA: 8A 80          '..'
        bra     ZFBD4                   ; FBCC: 20 06          ' .'
ZFBCE   aim     #$FD,M00E1              ; FBCE: 71 FD E1       'q..'
        aim     #$FB,M00E2              ; FBD1: 71 FB E2       'q..'
ZFBD4   aim     #$F7,M00AA              ; FBD4: 71 F7 AA       'q..'
ZFBD7   ldab    M0085                   ; FBD7: D6 85          '..'
        cmpb    #$08                    ; FBD9: C1 08          '..'
        bcc     ZFBEA                   ; FBDB: 24 0D          '$.'
        anda    #$7C                    ; FBDD: 84 7C          '.|'
        adda    #$01                    ; FBDF: 8B 01          '..'
        aim     #$77,M00AA              ; FBE1: 71 77 AA       'qw.'
        aim     #$FD,M00E1              ; FBE4: 71 FD E1       'q..'
        aim     #$FB,M00E2              ; FBE7: 71 FB E2       'q..'
ZFBEA   ldab    M00A4                   ; FBEA: D6 A4          '..'
        cmpb    #$02                    ; FBEC: C1 02          '..'
        bls     ZFBF5                   ; FBEE: 23 05          '#.'
        oim     #$04,M00E1              ; FBF0: 72 04 E1       'r..'
        bra     ZFBF8                   ; FBF3: 20 03          ' .'
ZFBF5   aim     #$FB,M00E1              ; FBF5: 71 FB E1       'q..'
ZFBF8   tim     #$04,M00E1              ; FBF8: 7B 04 E1       '{..'
        beq     ZFC08                   ; FBFB: 27 0B          ''.'
        anda    #$7F                    ; FBFD: 84 7F          '..'
        aim     #$77,M00AA              ; FBFF: 71 77 AA       'qw.'
        aim     #$FD,M00E1              ; FC02: 71 FD E1       'q..'
        aim     #$FB,M00E2              ; FC05: 71 FB E2       'q..'
ZFC08   tim     #$80,M00A8              ; FC08: 7B 80 A8       '{..'
        beq     ZFC37                   ; FC0B: 27 2A          ''*'
        tsta                            ; FC0D: 4D             'M'
        bmi     ZFC37                   ; FC0E: 2B 27          '+''
        ldab    M00AC                   ; FC10: D6 AC          '..'
        cmpb    #$05                    ; FC12: C1 05          '..'
        bhi     ZFC19                   ; FC14: 22 03          '".'
        oim     #$04,M00AA              ; FC16: 72 04 AA       'r..'
ZFC19   cmpb    #$1B                    ; FC19: C1 1B          '..'
        bcs     ZFC20                   ; FC1B: 25 03          '%.'
        oim     #$02,M00AA              ; FC1D: 72 02 AA       'r..'
ZFC20   ldab    M00A3                   ; FC20: D6 A3          '..'
        lsrb                            ; FC22: 54             'T'
        lsrb                            ; FC23: 54             'T'
        lsrb                            ; FC24: 54             'T'
        lsrb                            ; FC25: 54             'T'
        ldx     #MF084                  ; FC26: CE F0 84       '...'
        abx                             ; FC29: 3A             ':'
        ldab    $00,x                   ; FC2A: E6 00          '..'
        stab    M00D5                   ; FC2C: D7 D5          '..'
        aim     #$F7,M00E1              ; FC2E: 71 F7 E1       'q..'
        tstb                            ; FC31: 5D             ']'
        beq     ZFC37                   ; FC32: 27 03          ''.'
        oim     #$08,M00E1              ; FC34: 72 08 E1       'r..'
ZFC37   staa    M00A8                   ; FC37: 97 A8          '..'
        staa    M0080                   ; FC39: 97 80          '..'
        asla                            ; FC3B: 48             'H'
        bcc     ZFC43                   ; FC3C: 24 05          '$.'
        aim     #$EF,P3_DR              ; FC3E: 71 EF 06       'q..'
        bra     ZFC46                   ; FC41: 20 03          ' .'
ZFC43   oim     #$10,P3_DR              ; FC43: 72 10 06       'r..'
ZFC46   tim     #$01,M00A1              ; FC46: 7B 01 A1       '{..'
        bne     ZFC80                   ; FC49: 26 35          '&5'
        tim     #$80,M00A8              ; FC4B: 7B 80 A8       '{..'
        beq     ZFC80                   ; FC4E: 27 30          ''0'
        tim     #$02,M00E1              ; FC50: 7B 02 E1       '{..'
        bne     ZFC80                   ; FC53: 26 2B          '&+'
        tim     #$10,M00E1              ; FC55: 7B 10 E1       '{..'
        bne     ZFC80                   ; FC58: 26 26          '&&'
        tim     #$16,M00AA              ; FC5A: 7B 16 AA       '{..'
        bne     ZFC80                   ; FC5D: 26 21          '&!'
        tim     #$20,M00E0              ; FC5F: 7B 20 E0       '{ .'
        bne     ZFC71                   ; FC62: 26 0D          '&.'
        oim     #$20,M00E0              ; FC64: 72 20 E0       'r .'
        ldx     #M2200                  ; FC67: CE 22 00       '.".'
        stx     M00DE                   ; FC6A: DF DE          '..'
        oim     #$08,M00E0              ; FC6C: 72 08 E0       'r..'
        bra     ZFC86                   ; FC6F: 20 15          ' .'
ZFC71   tim     #$01,M00EA              ; FC71: 7B 01 EA       '{..'
        bne     ZFC7B                   ; FC74: 26 05          '&.'
        tim     #$08,M00E0              ; FC76: 7B 08 E0       '{..'
        bne     ZFC86                   ; FC79: 26 0B          '&.'
ZFC7B   oim     #$01,M00AA              ; FC7B: 72 01 AA       'r..'
        bra     ZFC86                   ; FC7E: 20 06          ' .'
ZFC80   aim     #$DF,M00E0              ; FC80: 71 DF E0       'q..'
        aim     #$FE,M00AA              ; FC83: 71 FE AA       'q..'
ZFC86   rts                             ; FC86: 39             '9'
ZFC87   ldaa    M00A1                   ; FC87: 96 A1          '..'
        anda    #$29                    ; FC89: 84 29          '.)'
        tim     #$04,M00EB              ; FC8B: 7B 04 EB       '{..'
        bne     ZFC92                   ; FC8E: 26 02          '&.'
        adda    #$80                    ; FC90: 8B 80          '..'
ZFC92   tim     #$08,M00EB              ; FC92: 7B 08 EB       '{..'
        bne     ZFC99                   ; FC95: 26 02          '&.'
        adda    #$40                    ; FC97: 8B 40          '.@'
ZFC99   tim     #$01,P3_DR              ; FC99: 7B 01 06       '{..'
        beq     ZFCA2                   ; FC9C: 27 04          ''.'
        adda    #$10                    ; FC9E: 8B 10          '..'
        anda    #$F7                    ; FCA0: 84 F7          '..'
ZFCA2   tim     #$02,P3_DR              ; FCA2: 7B 02 06       '{..'
        beq     ZFCAF                   ; FCA5: 27 08          ''.'
        adda    #$04                    ; FCA7: 8B 04          '..'
        aim     #$F8,M00A2              ; FCA9: 71 F8 A2       'q..'
        oim     #$05,M00A2              ; FCAC: 72 05 A2       'r..'
ZFCAF   staa    M00A1                   ; FCAF: 97 A1          '..'
        ldaa    M0094                   ; FCB1: 96 94          '..'
        cmpa    M0096                   ; FCB3: 91 96          '..'
        bcc     ZFCB9                   ; FCB5: 24 02          '$.'
        staa    M0096                   ; FCB7: 97 96          '..'
ZFCB9   ldaa    M009A                   ; FCB9: 96 9A          '..'
        cmpa    M009C                   ; FCBB: 91 9C          '..'
        bcc     ZFCC1                   ; FCBD: 24 02          '$.'
        staa    M009C                   ; FCBF: 97 9C          '..'
ZFCC1   ldaa    M0094                   ; FCC1: 96 94          '..'
        suba    M0096                   ; FCC3: 90 96          '..'
        lsra                            ; FCC5: 44             'D'
        lsra                            ; FCC6: 44             'D'
        adda    M0095                   ; FCC7: 9B 95          '..'
        cmpa    M0097                   ; FCC9: 91 97          '..'
        bls     ZFCCF                   ; FCCB: 23 02          '#.'
        staa    M0097                   ; FCCD: 97 97          '..'
ZFCCF   ldaa    M00EB                   ; FCCF: 96 EB          '..'
        anda    #$1F                    ; FCD1: 84 1F          '..'
        adda    #$A0                    ; FCD3: 8B A0          '..'
        tim     #$20,M00A1              ; FCD5: 7B 20 A1       '{ .'
        beq     ZFCDF                   ; FCD8: 27 05          ''.'
        tim     #$04,M00EB              ; FCDA: 7B 04 EB       '{..'
        bne     ZFD1F                   ; FCDD: 26 40          '&@'
ZFCDF   ldab    M00A1                   ; FCDF: D6 A1          '..'
        andb    #$09                    ; FCE1: C4 09          '..'
        tstb                            ; FCE3: 5D             ']'
        beq     ZFCEB                   ; FCE4: 27 05          ''.'
        tim     #$08,M00EB              ; FCE6: 7B 08 EB       '{..'
        bne     ZFD1F                   ; FCE9: 26 34          '&4'
ZFCEB   anda    #$9F                    ; FCEB: 84 9F          '..'
        adda    #$40                    ; FCED: 8B 40          '.@'
        tim     #$08,P3_DR              ; FCEF: 7B 08 06       '{..'
        bne     ZFD1F                   ; FCF2: 26 2B          '&+'
        anda    #$BF                    ; FCF4: 84 BF          '..'
        ldab    M00EB                   ; FCF6: D6 EB          '..'
        andb    #$03                    ; FCF8: C4 03          '..'
        tstb                            ; FCFA: 5D             ']'
        bne     ZFD1F                   ; FCFB: 26 22          '&"'
        aim     #$DF,M00AA              ; FCFD: 71 DF AA       'q..'
        anda    #$1F                    ; FD00: 84 1F          '..'
        staa    M00EB                   ; FD02: 97 EB          '..'
        tim     #$08,M00E2              ; FD04: 7B 08 E2       '{..'
        beq     ZFD1B                   ; FD07: 27 12          ''.'
        tim     #$01,M00E0              ; FD09: 7B 01 E0       '{..'
        bne     ZFD1E                   ; FD0C: 26 10          '&.'
        oim     #$01,M00E0              ; FD0E: 72 01 E0       'r..'
        tim     #$20,P3_DR              ; FD11: 7B 20 06       '{ .'
        bne     ZFD24                   ; FD14: 26 0E          '&.'
        ldx     #M0085                  ; FD16: CE 00 85       '...'
        stx     M00D8                   ; FD19: DF D8          '..'
ZFD1B   oim     #$20,P3_DR              ; FD1B: 72 20 06       'r .'
ZFD1E   rts                             ; FD1E: 39             '9'
ZFD1F   staa    M00EB                   ; FD1F: 97 EB          '..'
        oim     #$20,M00AA              ; FD21: 72 20 AA       'r .'
ZFD24   ldx     #M0025                  ; FD24: CE 00 25       '..%'
        stx     M00D8                   ; FD27: DF D8          '..'
        aim     #$DF,P3_DR              ; FD29: 71 DF 06       'q..'
        rts                             ; FD2C: 39             '9'
        stx     >M00FF                  ; FD2D: FF 00 FF       '...'
vec_IRQ_SCI
        aim     #$BF,M00E2              ; FD30: 71 BF E2       'q..'
        aim     #$FB,P3_DR              ; FD33: 71 FB 06       'q..'
        tim     #$40,SCI_TRCSR          ; FD36: 7B 40 11       '{@.'
        bne     ZFD86                   ; FD39: 26 4B          '&K'
        ldaa    SCI_RDR                 ; FD3B: 96 12          '..'
        staa    M00D0                   ; FD3D: 97 D0          '..'
        cmpa    #$18                    ; FD3F: 81 18          '..'
        bne     ZFD48                   ; FD41: 26 05          '&.'
        oim     #$40,M00E2              ; FD43: 72 40 E2       'r@.'
        bra     ZFD50                   ; FD46: 20 08          ' .'
ZFD48   jsr     ZFB0C                   ; FD48: BD FB 0C       '...'
        addb    #$10                    ; FD4B: CB 10          '..'
        cba                             ; FD4D: 11             '.'
        bne     ZFD86                   ; FD4E: 26 36          '&6'
ZFD50   tim     #$C0,SCI_TRCSR          ; FD50: 7B C0 11       '{..'
        beq     ZFD50                   ; FD53: 27 FB          ''.'
        bpl     ZFD86                   ; FD55: 2A 2F          '*/'
        ldaa    SCI_RDR                 ; FD57: 96 12          '..'
        tab                             ; FD59: 16             '.'
        eora    M00D0                   ; FD5A: 98 D0          '..'
        staa    M00D0                   ; FD5C: 97 D0          '..'
        tba                             ; FD5E: 17             '.'
        aslb                            ; FD5F: 58             'X'
        aslb                            ; FD60: 58             'X'
        cmpb    #$57                    ; FD61: C1 57          '.W'
        bhi     ZFD86                   ; FD63: 22 21          '"!'
        ldx     #MF000                  ; FD65: CE F0 00       '...'
        abx                             ; FD68: 3A             ':'
        psha                            ; FD69: 36             '6'
        ldd     $02,x                   ; FD6A: EC 02          '..'
        std     TMP_1                   ; FD6C: DD D3          '..'
        ldd     $00,x                   ; FD6E: EC 00          '..'
        std     M00D1                   ; FD70: DD D1          '..'
        tab                             ; FD72: 16             '.'
        clra                            ; FD73: 4F             'O'
        xgdx                            ; FD74: 18             '.'
        pulb                            ; FD75: 33             '3'
        tstb                            ; FD76: 5D             ']'
        bmi     ZFD81                   ; FD77: 2B 08          '+.'
        tim     #$40,Bitfield_mystery   ; FD79: 7B 40 D4       '{@.'
        bne     ZFD86                   ; FD7C: 26 08          '&.'
        jmp     ZFE02                   ; FD7E: 7E FE 02       '~..'
ZFD81   tim     #$80,Bitfield_mystery   ; FD81: 7B 80 D4       '{..'
        beq     ZFD8F                   ; FD84: 27 09          ''.'
ZFD86   ldaa    SCI_RDR                 ; FD86: 96 12          '..'
        oim     #$04,P3_DR              ; FD88: 72 04 06       'r..'
        oim     #$01,SCI_TRCSR          ; FD8B: 72 01 11       'r..'
        rti                             ; FD8E: 3B             ';'
ZFD8F   tim     #$01,Bitfield_mystery   ; FD8F: 7B 01 D4       '{..'
        beq     ZFD97                   ; FD92: 27 03          ''.'
        jsr     p4_bitflippy_1          ; FD94: BD F9 15       '...'
ZFD97   tim     #$C0,SCI_TRCSR          ; FD97: 7B C0 11       '{..'
        beq     ZFD97                   ; FD9A: 27 FB          ''.'
        bpl     ZFD86                   ; FD9C: 2A E8          '*.'
        ldaa    SCI_RDR                 ; FD9E: 96 12          '..'
        tab                             ; FDA0: 16             '.'
        eorb    M00D0                   ; FDA1: D8 D0          '..'
        stab    M00D0                   ; FDA3: D7 D0          '..'
        tim     #$08,Bitfield_mystery   ; FDA5: 7B 08 D4       '{..'
        beq     ZFDC0                   ; FDA8: 27 16          ''.'
        ldab    #$55                    ; FDAA: C6 55          '.U'
        cba                             ; FDAC: 11             '.'
        bne     ZFD86                   ; FDAD: 26 D7          '&.'
        clr     M00AF                   ; FDAF: 7F 00 AF       '...'
ZFDB2   clra                            ; FDB2: 4F             'O'
        staa    $00,x                   ; FDB3: A7 00          '..'
        inx                             ; FDB5: 08             '.'
        jsr     p4_bitflippy_2          ; FDB6: BD F9 5B       '..['
        dec     TMP_0                   ; FDB9: 7A 00 D2       'z..'
        bpl     ZFDB2                   ; FDBC: 2A F4          '*.'
        bra     ZFDD5                   ; FDBE: 20 15          ' .'
ZFDC0   tim     #$02,Bitfield_mystery   ; FDC0: 7B 02 D4       '{..'
        beq     ZFDC8                   ; FDC3: 27 03          ''.'
        staa    $00,x                   ; FDC5: A7 00          '..'
        inx                             ; FDC7: 08             '.'
ZFDC8   tim     #$01,Bitfield_mystery   ; FDC8: 7B 01 D4       '{..'
        beq     ZFDD0                   ; FDCB: 27 03          ''.'
        jsr     p4_bitflippy_2          ; FDCD: BD F9 5B       '..['
ZFDD0   dec     TMP_0                   ; FDD0: 7A 00 D2       'z..'
        bpl     ZFD97                   ; FDD3: 2A C2          '*.'
ZFDD5   jsr     p4_bitflippy_5          ; FDD5: BD F9 4B       '..K'
        aim     #$EF,SCI_TRCSR          ; FDD8: 71 EF 11       'q..'
        tim     #$40,P3_DR              ; FDDB: 7B 40 06       '{@.'
        bne     ZFDEB                   ; FDDE: 26 0B          '&.'
        aim     #$BF,M00E2              ; FDE0: 71 BF E2       'q..'
        tim     #$10,Bitfield_mystery   ; FDE3: 7B 10 D4       '{..'
        beq     ZFDEB                   ; FDE6: 27 03          ''.'
        jsr     ZF8C7                   ; FDE8: BD F8 C7       '...'
ZFDEB   tim     #$40,M00E2              ; FDEB: 7B 40 E2       '{@.'
        bne     ZFDF4                   ; FDEE: 26 04          '&.'
        ldaa    M00D0                   ; FDF0: 96 D0          '..'
        staa    SCI_TDR                 ; FDF2: 97 13          '..'
ZFDF4   tim     #$20,Bitfield_mystery   ; FDF4: 7B 20 D4       '{ .'
        beq     ZFDFC                   ; FDF7: 27 03          ''.'
        jsr     ZF9C4                   ; FDF9: BD F9 C4       '...'
ZFDFC   oim     #$11,SCI_TRCSR          ; FDFC: 72 11 11       'r..'
        ldaa    SCI_RDR                 ; FDFF: 96 12          '..'
        rti                             ; FE01: 3B             ';'
ZFE02   aim     #$EF,SCI_TRCSR          ; FE02: 71 EF 11       'q..'
        tim     #$04,Bitfield_mystery   ; FE05: 7B 04 D4       '{..'
        beq     ZFE10                   ; FE08: 27 06          ''.'
        jsr     p4_bitflippy_1          ; FE0A: BD F9 15       '...'
        jsr     p4_bitflippy_3          ; FE0D: BD F9 34       '..4'
ZFE10   tim     #$08,Bitfield_mystery   ; FE10: 7B 08 D4       '{..'
        beq     ZFE19                   ; FE13: 27 04          ''.'
        ldaa    #$EC                    ; FE15: 86 EC          '..'
        staa    TMP_1                   ; FE17: 97 D3          '..'
ZFE19   tim     #$08,Bitfield_mystery   ; FE19: 7B 08 D4       '{..'
        bne     ZFE2D                   ; FE1C: 26 0F          '&.'
        tim     #$04,Bitfield_mystery   ; FE1E: 7B 04 D4       '{..'
        bne     ZFE28                   ; FE21: 26 05          '&.'
        ldaa    $00,x                   ; FE23: A6 00          '..'
        inx                             ; FE25: 08             '.'
        bra     ZFE36                   ; FE26: 20 0E          ' .'
ZFE28   jsr     p4_bitflippy_4          ; FE28: BD F9 88       '...'
        bra     ZFE36                   ; FE2B: 20 09          ' .'
ZFE2D   ldaa    TMP_1                   ; FE2D: 96 D3          '..'
        adda    #$14                    ; FE2F: 8B 14          '..'
        staa    TMP_1                   ; FE31: 97 D3          '..'
        jsr     ZF580                   ; FE33: BD F5 80       '...'
ZFE36   tim     #$20,SCI_TRCSR          ; FE36: 7B 20 11       '{ .'
        beq     ZFE36                   ; FE39: 27 FB          ''.'
        staa    SCI_TDR                 ; FE3B: 97 13          '..'
        eora    M00D0                   ; FE3D: 98 D0          '..'
        staa    M00D0                   ; FE3F: 97 D0          '..'
        dec     TMP_0                   ; FE41: 7A 00 D2       'z..'
        bpl     ZFE19                   ; FE44: 2A D3          '*.'
        jsr     p4_bitflippy_5          ; FE46: BD F9 4B       '..K'
        ldaa    M00D0                   ; FE49: 96 D0          '..'
ZFE4B   tim     #$20,SCI_TRCSR          ; FE4B: 7B 20 11       '{ .'
        beq     ZFE4B                   ; FE4E: 27 FB          ''.'
        staa    SCI_TDR                 ; FE50: 97 13          '..'
        oim     #$11,SCI_TRCSR          ; FE52: 72 11 11       'r..'
        ldaa    SCI_RDR                 ; FE55: 96 12          '..'
        rti                             ; FE57: 3B             ';'
        fcb     $00                     ; FE58: 00             '.'
        stx     M717F                   ; FE59: FF 71 7F       '.q.'
        cmpb    $D6,x                   ; FE5C: E1 D6          '..'
        fcb     $02                     ; FE5E: 02             '.'
        comb                            ; FE5F: 53             'S'
        andb    #$07                    ; FE60: C4 07          '..'
        bne     ZFE6D                   ; FE62: 26 09          '&.'
        ldd     M000D                   ; FE64: DC 0D          '..'
        anda    #$3F                    ; FE66: 84 3F          '.?'
        std     M0091                   ; FE68: DD 91          '..'
        jmp     ZFF25                   ; FE6A: 7E FF 25       '~.%'
ZFE6D   pshb                            ; FE6D: 37             '7'
        aslb                            ; FE6E: 58             'X'
        ldx     #MF068                  ; FE6F: CE F0 68       '..h'
        abx                             ; FE72: 3A             ':'
        clr     M008E                   ; FE73: 7F 00 8E       '...'
        ldab    $01,x                   ; FE76: E6 01          '..'
        ldaa    M0092                   ; FE78: 96 92          '..'
        mul                             ; FE7A: 3D             '='
        std     M008F                   ; FE7B: DD 8F          '..'
        ldab    $01,x                   ; FE7D: E6 01          '..'
        ldaa    M0091                   ; FE7F: 96 91          '..'
        mul                             ; FE81: 3D             '='
        addd    M008E                   ; FE82: D3 8E          '..'
        tst     $00,x                   ; FE84: 6D 00          'm.'
        beq     ZFE8A                   ; FE86: 27 02          ''.'
        addd    M0091                   ; FE88: D3 91          '..'
ZFE8A   std     M008E                   ; FE8A: DD 8E          '..'
        clr     M008B                   ; FE8C: 7F 00 8B       '...'
        ldab    #$5E                    ; FE8F: C6 5E          '.^'
        ldaa    M000E                   ; FE91: 96 0E          '..'
        mul                             ; FE93: 3D             '='
        std     M008C                   ; FE94: DD 8C          '..'
        ldab    #$5E                    ; FE96: C6 5E          '.^'
        ldaa    M000D                   ; FE98: 96 0D          '..'
        anda    #$3F                    ; FE9A: 84 3F          '.?'
        mul                             ; FE9C: 3D             '='
        addd    M008B                   ; FE9D: D3 8B          '..'
        std     M008B                   ; FE9F: DD 8B          '..'
        ldd     M000D                   ; FEA1: DC 0D          '..'
        anda    #$3F                    ; FEA3: 84 3F          '.?'
        addd    M008B                   ; FEA5: D3 8B          '..'
        std     M008B                   ; FEA7: DD 8B          '..'
        ldd     M008C                   ; FEA9: DC 8C          '..'
        subd    M008F                   ; FEAB: 93 8F          '..'
        std     M008C                   ; FEAD: DD 8C          '..'
        ldaa    M008B                   ; FEAF: 96 8B          '..'
        sbca    M008E                   ; FEB1: 92 8E          '..'
        staa    M008B                   ; FEB3: 97 8B          '..'
        bcc     ZFEC5                   ; FEB5: 24 0E          '$.'
        ldd     #P1_DDR                 ; FEB7: CC 00 00       '...'
        std     M008C                   ; FEBA: DD 8C          '..'
        oim     #$80,M00E1              ; FEBC: 72 80 E1       'r..'
        pulb                            ; FEBF: 33             '3'
        jsr     ZFF2A                   ; FEC0: BD FF 2A       '..*'
        bra     ZFF25                   ; FEC3: 20 60          ' `'
ZFEC5   clr     M008E                   ; FEC5: 7F 00 8E       '...'
        ldx     #M0020                  ; FEC8: CE 00 20       '.. '
        clr     M008F                   ; FECB: 7F 00 8F       '...'
        clr     M0090                   ; FECE: 7F 00 90       '...'
ZFED1   rol     M008E                   ; FED1: 79 00 8E       'y..'
        rol     M008D                   ; FED4: 79 00 8D       'y..'
        rol     M008C                   ; FED7: 79 00 8C       'y..'
        rol     M008B                   ; FEDA: 79 00 8B       'y..'
        rol     M0090                   ; FEDD: 79 00 90       'y..'
        rol     M008F                   ; FEE0: 79 00 8F       'y..'
        ldd     M008F                   ; FEE3: DC 8F          '..'
        subd    M0091                   ; FEE5: 93 91          '..'
        bcs     ZFEEE                   ; FEE7: 25 05          '%.'
        sec                             ; FEE9: 0D             '.'
        std     M008F                   ; FEEA: DD 8F          '..'
        bra     ZFEEF                   ; FEEC: 20 01          ' .'
ZFEEE   clc                             ; FEEE: 0C             '.'
ZFEEF   dex                             ; FEEF: 09             '.'
        bne     ZFED1                   ; FEF0: 26 DF          '&.'
        rol     M008E                   ; FEF2: 79 00 8E       'y..'
        rol     M008D                   ; FEF5: 79 00 8D       'y..'
        rol     M008C                   ; FEF8: 79 00 8C       'y..'
        rol     M008B                   ; FEFB: 79 00 8B       'y..'
        ldx     #MF073                  ; FEFE: CE F0 73       '..s'
        pulb                            ; FF01: 33             '3'
        pshb                            ; FF02: 37             '7'
        abx                             ; FF03: 3A             ':'
        ldaa    $00,x                   ; FF04: A6 00          '..'
ZFF06   asl     M008E                   ; FF06: 78 00 8E       'x..'
        rol     M008D                   ; FF09: 79 00 8D       'y..'
        rol     M008C                   ; FF0C: 79 00 8C       'y..'
MFF0F   rol     M008B                   ; FF0F: 79 00 8B       'y..'
        deca                            ; FF12: 4A             'J'
        bne     ZFF06                   ; FF13: 26 F1          '&.'
        tst     M008B                   ; FF15: 7D 00 8B       '}..'
        beq     ZFF22                   ; FF18: 27 08          ''.'
        ldd     #MFF00                  ; FF1A: CC FF 00       '...'
        std     M008C                   ; FF1D: DD 8C          '..'
        oim     #$80,M00E1              ; FF1F: 72 80 E1       'r..'
ZFF22   pulb                            ; FF22: 33             '3'
        bsr     ZFF2A                   ; FF23: 8D 05          '..'
ZFF25   ldaa    TIMER_CSR               ; FF25: 96 08          '..'
        ldab    M000D                   ; FF27: D6 0D          '..'
        rti                             ; FF29: 3B             ';'
ZFF2A   tstb                            ; FF2A: 5D             ']'
        beq     ZFF7E                   ; FF2B: 27 51          ''Q'
        ldx     #M0080                  ; FF2D: CE 00 80       '...'
        abx                             ; FF30: 3A             ':'
        clra                            ; FF31: 4F             'O'
        sec                             ; FF32: 0D             '.'
ZFF33   rola                            ; FF33: 49             'I'
        decb                            ; FF34: 5A             'Z'
        bne     ZFF33                   ; FF35: 26 FC          '&.'
        tim     #$80,M00E1              ; FF37: 7B 80 E1       '{..'
        beq     ZFF40                   ; FF3A: 27 04          ''.'
        oraa    M00EB                   ; FF3C: 9A EB          '..'
        bra     ZFF43                   ; FF3E: 20 03          ' .'
ZFF40   coma                            ; FF40: 43             'C'
        anda    M00EB                   ; FF41: 94 EB          '..'
ZFF43   staa    M00EB                   ; FF43: 97 EB          '..'
        tst     $05,x                   ; FF45: 6D 05          'm.'
        bpl     ZFF4B                   ; FF47: 2A 02          '*.'
        dec     $00,x                   ; FF49: 6A 00          'j.'
ZFF4B   clr     M008B                   ; FF4B: 7F 00 8B       '...'
        ldaa    #$02                    ; FF4E: 86 02          '..'
        staa    M008E                   ; FF50: 97 8E          '..'
        ldab    $05,x                   ; FF52: E6 05          '..'
        ldaa    $00,x                   ; FF54: A6 00          '..'
        std     M008F                   ; FF56: DD 8F          '..'
ZFF58   addd    M008F                   ; FF58: D3 8F          '..'
        bcc     ZFF5F                   ; FF5A: 24 03          '$.'
        inc     M008B                   ; FF5C: 7C 00 8B       '|..'
ZFF5F   dec     M008E                   ; FF5F: 7A 00 8E       'z..'
        bne     ZFF58                   ; FF62: 26 F4          '&.'
        addd    M008C                   ; FF64: D3 8C          '..'
        bcc     ZFF6B                   ; FF66: 24 03          '$.'
        inc     M008B                   ; FF68: 7C 00 8B       '|..'
ZFF6B   ror     M008B                   ; FF6B: 76 00 8B       'v..'
        rora                            ; FF6E: 46             'F'
        rorb                            ; FF6F: 56             'V'
        ror     M008B                   ; FF70: 76 00 8B       'v..'
        rora                            ; FF73: 46             'F'
        rorb                            ; FF74: 56             'V'
        adcb    #$00                    ; FF75: C9 00          '..'
        stab    $05,x                   ; FF77: E7 05          '..'
        aslb                            ; FF79: 58             'X'
        adca    #$00                    ; FF7A: 89 00          '..'
        staa    $00,x                   ; FF7C: A7 00          '..'
ZFF7E   aim     #$7F,M00E1              ; FF7E: 71 7F E1       'q..'
        rts                             ; FF81: 39             '9'
        fcb     $00                     ; FF82: 00             '.'
        stx     >M005F                  ; FF83: FF 00 5F       '.._'
        ldaa    TIMER_CSR               ; FF86: 96 08          '..'
        ldaa    TIMER_OUT_COMP_H        ; FF88: 96 0B          '..'
        anda    #$C0                    ; FF8A: 84 C0          '..'
        adda    #$40                    ; FF8C: 8B 40          '.@'
        std     TIMER_OUT_COMP_H        ; FF8E: DD 0B          '..'
        asla                            ; FF90: 48             'H'
        bmi     ZFFBE                   ; FF91: 2B 2B          '++'
        aim     #$FE,TIMER_CSR          ; FF93: 71 FE 08       'q..'
        oim     #$08,P1_DR              ; FF96: 72 08 02       'r..'
        ldab    P1_DR                   ; FF99: D6 02          '..'
        comb                            ; FF9B: 53             'S'
        andb    #$07                    ; FF9C: C4 07          '..'
        cmpb    #$05                    ; FF9E: C1 05          '..'
        beq     ZFFA9                   ; FFA0: 27 07          ''.'
        dec     P1_DR                   ; FFA2: 7A 00 02       'z..'
        ldaa    #$FF                    ; FFA5: 86 FF          '..'
        bra     ZFFAD                   ; FFA7: 20 04          ' .'
ZFFA9   oim     #$07,P1_DR              ; FFA9: 72 07 02       'r..'
        clra                            ; FFAC: 4F             'O'
ZFFAD   staa    M008C                   ; FFAD: 97 8C          '..'
        clr     M008D                   ; FFAF: 7F 00 8D       '...'
        tim     #$80,M00E1              ; FFB2: 7B 80 E1       '{..'
        beq     ZFFBA                   ; FFB5: 27 03          ''.'
        jsr     ZFF2A                   ; FFB7: BD FF 2A       '..*'
ZFFBA   oim     #$80,M00E1              ; FFBA: 72 80 E1       'r..'
        rti                             ; FFBD: 3B             ';'
ZFFBE   oim     #$01,TIMER_CSR          ; FFBE: 72 01 08       'r..'
        aim     #$F7,P1_DR              ; FFC1: 71 F7 02       'q..'
        ldx     M00D8                   ; FFC4: DE D8          '..'
        dex                             ; FFC6: 09             '.'
        bne     ZFFCC                   ; FFC7: 26 03          '&.'
        aim     #$FE,M00E0              ; FFC9: 71 FE E0       'q..'
ZFFCC   stx     M00D8                   ; FFCC: DF D8          '..'
        ldx     M00DA                   ; FFCE: DE DA          '..'
        dex                             ; FFD0: 09             '.'
        bne     ZFFD6                   ; FFD1: 26 03          '&.'
        aim     #$FD,M00E0              ; FFD3: 71 FD E0       'q..'
ZFFD6   stx     M00DA                   ; FFD6: DF DA          '..'
        ldx     M00DC                   ; FFD8: DE DC          '..'
        dex                             ; FFDA: 09             '.'
        bne     ZFFE0                   ; FFDB: 26 03          '&.'
        aim     #$FB,M00E0              ; FFDD: 71 FB E0       'q..'
ZFFE0   stx     M00DC                   ; FFE0: DF DC          '..'
        ldx     M00DE                   ; FFE2: DE DE          '..'
        dex                             ; FFE4: 09             '.'
        bne     ZFFEA                   ; FFE5: 26 03          '&.'
        aim     #$F7,M00E0              ; FFE7: 71 F7 E0       'q..'
ZFFEA   stx     M00DE                   ; FFEA: DF DE          '..'
        rti                             ; FFEC: 3B             ';'
        stx     vec_IRQ_EXT             ; FFED: FF F0 90       '...'
        fdb     vec_IRQ_SCI             ; FFF0: FD 30          '.0'
        fdb     vec_IRQ_EXT             ; FFF2: F0 90          '..'
        fdb     vec_IRQ_OCF             ; FFF4: FF 85          '..'
        fdb     vec_IRQ_ICF             ; FFF6: FE 5A          '.Z'
        fdb     vec_IRQ_EXT             ; FFF8: F0 90          '..'
        fdb     vec_IRQ_EXT             ; FFFA: F0 90          '..'
        fdb     vec_IRQ_EXT             ; FFFC: F0 90          '..'
        fdb     vec_IRQ_EXT             ; FFFE: F0 90          '..'


        end
