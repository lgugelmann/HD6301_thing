        ifndef __keyboard_keymap_us_inc
__keyboard_keymap_us_inc = 1

keycode_to_ascii:
        ;      0   1   2   3   4   5   6   7   8   9   a   b   c   d   e   f
        .byt $00,$01,$02,$03,$04,$05,$06,$07,$08,$09,$0a,$0b,$0c,$0d,"`",$0f ; 0
        .byt $10,$11,$12,$13,$14,"q","1",$17,$18,$19,"z","s","a","w","2",$1f ; 1
        .byt $20,"c","x","d","e","4","3",$27,$28," ","v","f","t","r","5",$2f ; 2
        .byt $30,"n","b","h","g","y","6",$37,$38,$39,"m","j","u","7","8",$3f ; 3
        .byt $40,",","k","i","o","0","9",$47,$48,".","/","l",";","p","-",$4f ; 4
        .byt $50,$51,"'",$53,"[","=",$56,$57,$58,$59,$5a,"]",$5c,"\\",$5e,$5f; 5
        .byt $60,$61,$62,$63,$64,$65,$66,$67,$68,$69,$6a,$6b,$6c,$6d,$6e,$6f ; 6
        .byt $70,$71,$72,$73,$74,$75,$76,$77,$78,$79,$7a,$7b,$7c,$7d,$7e,$7f ; 7
        .byt $80,$81,$82,$83,$84,$85,$86,$87,$88,$89,$8a,$8b,$8c,$8d,$8e,$8f ; 8
        .byt $90,$91,$92,$93,$94,$95,$96,$97,$98,$99,$9a,$9b,$9c,$9d,$9e,$9f ; 9
        .byt $a0,$a1,$a2,$a3,$a4,$a5,$a6,$a7,$a8,$a9,$aa,$ab,$ac,$ad,$ae,$af ; a
        .byt $b0,$b1,$b2,$b3,$b4,$b5,$b6,$b7,$b8,$b9,$ba,$bb,$bc,$bd,$be,$bf ; b
        .byt $c0,$c1,$c2,$c3,$c4,$c5,$c6,$c7,$c8,$c9,$ca,$cb,$cc,$cd,$ce,$cf ; c
        .byt $d0,$d1,$d2,$d3,$d4,$d5,$d6,$d7,$d8,$d9,$da,$db,$dc,$dd,$de,$df ; d
        .byt $e0,$e1,$e2,$e3,$e4,$e5,$e6,$e7,$e8,$e9,$ea,$eb,$ec,$ed,$ee,$ef ; e
        .byt $f0,$f1,$f2,$f3,$f4,$f5,$f6,$f7,$f8,$f9,$fa,$fb,$fc,$fd,$fe,$ff ; f

keycode_to_ascii_shifted:
        ;      0   1   2   3   4   5   6   7   8   9   a   b   c   d   e   f
        .byt $00,$01,$02,$03,$04,$05,$06,$07,$08,$09,$0a,$0b,$0c,$0d,"~",$0f ; 0
        .byt $10,$11,$12,$13,$14,"Q","!",$17,$18,$19,"Z","S","A","W","@",$1f ; 1
        .byt $20,"C","X","D","E","$","#",$27,$28," ","V","F","T","R","%",$2f ; 2
        .byt $30,"N","B","H","G","Y","^",$37,$38,$39,"M","J","U","&","*",$3f ; 3
        .byt $40,"<","K","I","O",")","(",$47,$48,">","?","L",":","P","_",$4f ; 4
        .byt $50,$51,'"',$53,"{","+",$56,$57,$58,$59,$5a,"}",$5c,"|",$5e,$5f ; 5
        .byt $60,$61,$62,$63,$64,$65,$66,$67,$68,$69,$6a,$6b,$6c,$6d,$6e,$6f ; 6
        .byt $70,$71,$72,$73,$74,$75,$76,$77,$78,$79,$7a,$7b,$7c,$7d,$7e,$7f ; 7
        .byt $80,$81,$82,$83,$84,$85,$86,$87,$88,$89,$8a,$8b,$8c,$8d,$8e,$8f ; 8
        .byt $90,$91,$92,$93,$94,$95,$96,$97,$98,$99,$9a,$9b,$9c,$9d,$9e,$9f ; 9
        .byt $a0,$a1,$a2,$a3,$a4,$a5,$a6,$a7,$a8,$a9,$aa,$ab,$ac,$ad,$ae,$af ; a
        .byt $b0,$b1,$b2,$b3,$b4,$b5,$b6,$b7,$b8,$b9,$ba,$bb,$bc,$bd,$be,$bf ; b
        .byt $c0,$c1,$c2,$c3,$c4,$c5,$c6,$c7,$c8,$c9,$ca,$cb,$cc,$cd,$ce,$cf ; c
        .byt $d0,$d1,$d2,$d3,$d4,$d5,$d6,$d7,$d8,$d9,$da,$db,$dc,$dd,$de,$df ; d
        .byt $e0,$e1,$e2,$e3,$e4,$e5,$e6,$e7,$e8,$e9,$ea,$eb,$ec,$ed,$ee,$ef ; e
        .byt $f0,$f1,$f2,$f3,$f4,$f5,$f6,$f7,$f8,$f9,$fa,$fb,$fc,$fd,$fe,$ff ; f

keycode_to_flags:
        ;      0   1   2   3   4   5   6   7   8   9   a   b   c   d   e   f
        .byt   2,  2,  2,  2,  2,  2,  2,  2,  2,  2,  2,  2,  2,  2,  1,  2 ; 0
        .byt   2,  2,  2,  2,  2,  1,  1,  2,  2,  2,  1,  1,  1,  1,  1,  2 ; 1
        .byt   2,  1,  1,  1,  1,  1,  1,  2,  2,  1,  1,  1,  1,  1,  1,  2 ; 2
        .byt   2,  1,  1,  1,  1,  1,  1,  2,  2,  2,  1,  1,  1,  1,  1,  2 ; 3
        .byt   2,  1,  1,  1,  1,  1,  1,  2,  2,  1,  1,  1,  1,  1,  1,  2 ; 4
        .byt   2,  2,  1,  2,  1,  1,  2,  2,  2,  2,  2,  1,  2,  1,  2,  2 ; 5
        .byt   2,  2,  2,  2,  2,  2,  2,  2,  2,  2,  2,  2,  2,  2,  2,  2 ; 6
        .byt   2,  2,  2,  2,  2,  2,  2,  2,  2,  2,  2,  2,  2,  2,  2,  2 ; 7
        .byt   2,  2,  2,  2,  2,  2,  2,  2,  2,  2,  2,  2,  2,  2,  2,  2 ; 8
        .byt   2,  2,  2,  2,  2,  2,  2,  2,  2,  2,  2,  2,  2,  2,  2,  2 ; 9
        .byt   2,  2,  2,  2,  2,  2,  2,  2,  2,  2,  2,  2,  2,  2,  2,  2 ; a
        .byt   2,  2,  2,  2,  2,  2,  2,  2,  2,  2,  2,  2,  2,  2,  2,  2 ; b
        .byt   2,  2,  2,  2,  2,  2,  2,  2,  2,  2,  2,  2,  2,  2,  2,  2 ; c
        .byt   2,  2,  2,  2,  2,  2,  2,  2,  2,  2,  2,  2,  2,  2,  2,  2 ; d
        .byt   2,  2,  2,  2,  2,  2,  2,  2,  2,  2,  2,  2,  2,  2,  2,  2 ; e
        .byt   2,  2,  2,  2,  2,  2,  2,  2,  2,  2,  2,  2,  2,  2,  2,  2 ; f

        endif
