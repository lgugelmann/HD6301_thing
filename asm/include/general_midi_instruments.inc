        ifndef __general_midi_instruments
__general_midi_instruments = 1

general_midi_instruments:
        .byt $01,$8f,$f2,$f4,$00,$01,$06,$f2,$f7,$00,$38 ; 0
        .byt $01,$4b,$f2,$f4,$00,$01,$00,$f2,$f7,$00,$38 ; 1
        .byt $01,$49,$f2,$f4,$00,$01,$00,$f2,$f6,$00,$38 ; 2
        .byt $81,$12,$f2,$f7,$00,$41,$00,$f2,$f7,$00,$36 ; 3
        .byt $01,$57,$f1,$f7,$00,$01,$00,$f2,$f7,$00,$30 ; 4
        .byt $01,$93,$f1,$f7,$00,$01,$00,$f2,$f7,$00,$30 ; 5
        .byt $01,$80,$a1,$f2,$00,$16,$0e,$f2,$f5,$00,$38 ; 6
        .byt $01,$92,$c2,$f8,$00,$01,$00,$c2,$f8,$00,$3a ; 7
        .byt $0c,$5c,$f6,$f4,$00,$81,$00,$f3,$f5,$00,$30 ; 8
        .byt $07,$97,$f3,$f2,$00,$11,$80,$f2,$f1,$00,$32 ; 9
        .byt $17,$21,$54,$f4,$00,$01,$00,$f4,$f4,$00,$32 ; 10
        .byt $98,$62,$f3,$f6,$00,$81,$00,$f2,$f6,$00,$30 ; 11
        .byt $18,$23,$f6,$f6,$00,$01,$00,$e7,$f7,$00,$30 ; 12
        .byt $15,$91,$f6,$f6,$00,$01,$00,$f6,$f6,$00,$34 ; 13
        .byt $45,$59,$d3,$f3,$00,$81,$80,$a3,$f3,$00,$3c ; 14
        .byt $03,$49,$75,$f5,$01,$81,$80,$b5,$f5,$00,$34 ; 15
        .byt $71,$92,$f6,$14,$00,$31,$00,$f1,$07,$00,$32 ; 16
        .byt $72,$14,$c7,$58,$00,$30,$00,$c7,$08,$00,$32 ; 17
        .byt $70,$44,$aa,$18,$00,$b1,$00,$8a,$08,$00,$34 ; 18
        .byt $23,$93,$97,$23,$01,$b1,$00,$55,$14,$00,$34 ; 19
        .byt $61,$13,$97,$04,$01,$b1,$80,$55,$04,$00,$30 ; 20
        .byt $24,$48,$98,$2a,$01,$b1,$00,$46,$1a,$00,$3c ; 21
        .byt $61,$13,$91,$06,$01,$21,$00,$61,$07,$00,$3a ; 22
        .byt $21,$13,$71,$06,$00,$a1,$89,$61,$07,$00,$36 ; 23
        .byt $02,$9c,$f3,$94,$01,$41,$80,$f3,$c8,$00,$3c ; 24
        .byt $03,$54,$f3,$9a,$01,$11,$00,$f1,$e7,$00,$3c ; 25
        .byt $23,$5f,$f1,$3a,$00,$21,$00,$f2,$f8,$00,$30 ; 26
        .byt $03,$87,$f6,$22,$01,$21,$80,$f3,$f8,$00,$36 ; 27
        .byt $03,$47,$f9,$54,$00,$21,$00,$f6,$3a,$00,$30 ; 28
        .byt $23,$4a,$91,$41,$01,$21,$05,$84,$19,$00,$38 ; 29
        .byt $23,$4a,$95,$19,$01,$21,$00,$94,$19,$00,$38 ; 30
        .byt $09,$a1,$20,$4f,$00,$84,$80,$d1,$f8,$00,$38 ; 31
        .byt $21,$1e,$94,$06,$00,$a2,$00,$c3,$a6,$00,$32 ; 32
        .byt $31,$12,$f1,$28,$00,$31,$00,$f1,$18,$00,$3a ; 33
        .byt $31,$8d,$f1,$e8,$00,$31,$00,$f1,$78,$00,$3a ; 34
        .byt $31,$5b,$51,$28,$00,$32,$00,$71,$48,$00,$3c ; 35
        .byt $01,$8b,$a1,$9a,$00,$21,$40,$f2,$df,$00,$38 ; 36
        .byt $21,$8b,$a2,$16,$00,$21,$08,$a1,$df,$00,$38 ; 37
        .byt $31,$8b,$f4,$e8,$00,$31,$00,$f1,$78,$00,$3a ; 38
        .byt $31,$12,$f1,$28,$00,$31,$00,$f1,$18,$00,$3a ; 39
        .byt $31,$15,$dd,$13,$01,$21,$00,$56,$26,$00,$38 ; 40
        .byt $31,$16,$dd,$13,$01,$21,$00,$66,$06,$00,$38 ; 41
        .byt $71,$49,$d1,$1c,$01,$31,$00,$61,$0c,$00,$38 ; 42
        .byt $21,$4d,$71,$12,$01,$23,$80,$72,$06,$00,$32 ; 43
        .byt $f1,$40,$f1,$21,$01,$e1,$00,$6f,$16,$00,$32 ; 44
        .byt $02,$1a,$f5,$75,$01,$01,$80,$85,$35,$00,$30 ; 45
        .byt $02,$1d,$f5,$75,$01,$01,$80,$f3,$f4,$00,$30 ; 46
        .byt $10,$41,$f5,$05,$01,$11,$00,$f2,$c3,$00,$32 ; 47
        .byt $21,$9b,$b1,$25,$01,$a2,$01,$72,$08,$00,$3e ; 48
        .byt $a1,$98,$7f,$03,$01,$21,$00,$3f,$07,$01,$30 ; 49
        .byt $a1,$93,$c1,$12,$00,$61,$00,$4f,$05,$00,$3a ; 50
        .byt $21,$18,$c1,$22,$00,$61,$00,$4f,$05,$00,$3c ; 51
        .byt $31,$5b,$f4,$15,$00,$72,$83,$8a,$05,$00,$30 ; 52
        .byt $a1,$90,$74,$39,$00,$61,$00,$71,$67,$00,$30 ; 53
        .byt $71,$57,$54,$05,$00,$72,$00,$7a,$05,$00,$3c ; 54
        .byt $90,$00,$54,$63,$00,$41,$00,$a5,$45,$00,$38 ; 55
        .byt $21,$92,$85,$17,$00,$21,$01,$8f,$09,$00,$3c ; 56
        .byt $21,$94,$75,$17,$00,$21,$05,$8f,$09,$00,$3c ; 57
        .byt $21,$94,$76,$15,$00,$61,$00,$82,$37,$00,$3c ; 58
        .byt $31,$43,$9e,$17,$01,$21,$00,$62,$2c,$01,$32 ; 59
        .byt $21,$9b,$61,$6a,$00,$21,$00,$7f,$0a,$00,$32 ; 60
        .byt $61,$8a,$75,$1f,$00,$22,$06,$74,$0f,$00,$38 ; 61
        .byt $a1,$86,$72,$55,$01,$21,$83,$71,$18,$00,$30 ; 62
        .byt $21,$4d,$54,$3c,$00,$21,$00,$a6,$1c,$00,$38 ; 63
        .byt $31,$8f,$93,$02,$01,$61,$00,$72,$0b,$00,$38 ; 64
        .byt $31,$8e,$93,$03,$01,$61,$00,$72,$09,$00,$38 ; 65
        .byt $31,$91,$93,$03,$01,$61,$00,$82,$09,$00,$3a ; 66
        .byt $31,$8e,$93,$0f,$01,$61,$00,$72,$0f,$00,$3a ; 67
        .byt $21,$4b,$aa,$16,$01,$21,$00,$8f,$0a,$00,$38 ; 68
        .byt $31,$90,$7e,$17,$01,$21,$00,$8b,$0c,$01,$36 ; 69
        .byt $31,$81,$75,$19,$01,$32,$00,$61,$19,$00,$30 ; 70
        .byt $32,$90,$9b,$21,$00,$21,$00,$72,$17,$00,$34 ; 71
        .byt $e1,$1f,$85,$5f,$00,$e1,$00,$65,$1a,$00,$30 ; 72
        .byt $e1,$46,$88,$5f,$00,$e1,$00,$65,$1a,$00,$30 ; 73
        .byt $a1,$9c,$75,$1f,$00,$21,$00,$75,$0a,$00,$32 ; 74
        .byt $31,$8b,$84,$58,$00,$21,$00,$65,$1a,$00,$30 ; 75
        .byt $e1,$4c,$66,$56,$00,$a1,$00,$65,$26,$00,$30 ; 76
        .byt $62,$cb,$76,$46,$00,$a1,$00,$55,$36,$00,$30 ; 77
        .byt $62,$99,$57,$07,$00,$a1,$00,$56,$07,$00,$3b ; 78
        .byt $62,$93,$77,$07,$00,$a1,$00,$76,$07,$00,$3b ; 79
        .byt $22,$59,$ff,$03,$02,$21,$00,$ff,$0f,$00,$30 ; 80
        .byt $21,$0e,$ff,$0f,$01,$21,$00,$ff,$0f,$01,$30 ; 81
        .byt $22,$46,$86,$55,$00,$21,$80,$64,$18,$00,$30 ; 82
        .byt $21,$45,$66,$12,$00,$a1,$00,$96,$0a,$00,$30 ; 83
        .byt $21,$8b,$92,$2a,$01,$22,$00,$91,$2a,$00,$30 ; 84
        .byt $a2,$9e,$df,$05,$00,$61,$40,$6f,$07,$00,$32 ; 85
        .byt $20,$1a,$ef,$01,$00,$60,$00,$8f,$06,$02,$30 ; 86
        .byt $21,$8f,$f1,$29,$00,$21,$80,$f4,$09,$00,$3a ; 87
        .byt $77,$a5,$53,$94,$00,$a1,$00,$a0,$05,$00,$32 ; 88
        .byt $61,$1f,$a8,$11,$00,$b1,$80,$25,$03,$00,$3a ; 89
        .byt $61,$17,$91,$34,$00,$61,$00,$55,$16,$00,$3c ; 90
        .byt $71,$5d,$54,$01,$00,$72,$00,$6a,$03,$00,$30 ; 91
        .byt $21,$97,$21,$43,$00,$a2,$00,$42,$35,$00,$38 ; 92
        .byt $a1,$1c,$a1,$77,$01,$21,$00,$31,$47,$01,$30 ; 93
        .byt $21,$89,$11,$33,$00,$61,$03,$42,$25,$00,$3a ; 94
        .byt $a1,$15,$11,$47,$01,$21,$00,$cf,$07,$00,$30 ; 95
        .byt $3a,$ce,$f8,$f6,$00,$51,$00,$86,$02,$00,$32 ; 96
        .byt $21,$15,$21,$23,$01,$21,$00,$41,$13,$00,$30 ; 97
        .byt $06,$5b,$74,$95,$00,$01,$00,$a5,$72,$00,$30 ; 98
        .byt $22,$92,$b1,$81,$00,$61,$83,$f2,$26,$00,$3c ; 99
        .byt $41,$4d,$f1,$51,$01,$42,$00,$f2,$f5,$00,$30 ; 100
        .byt $61,$94,$11,$51,$01,$a3,$80,$11,$13,$00,$36 ; 101
        .byt $61,$8c,$11,$31,$00,$a1,$80,$1d,$03,$00,$36 ; 102
        .byt $a4,$4c,$f3,$73,$01,$61,$00,$81,$23,$00,$34 ; 103
        .byt $02,$85,$d2,$53,$00,$07,$03,$f2,$f6,$01,$30 ; 104
        .byt $11,$0c,$a3,$11,$01,$13,$80,$a2,$e5,$00,$30 ; 105
        .byt $11,$06,$f6,$41,$01,$11,$00,$f2,$e6,$02,$34 ; 106
        .byt $93,$91,$d4,$32,$00,$91,$00,$eb,$11,$01,$38 ; 107
        .byt $04,$4f,$fa,$56,$00,$01,$00,$c2,$05,$00,$3c ; 108
        .byt $21,$49,$7c,$20,$00,$22,$00,$6f,$0c,$01,$36 ; 109
        .byt $31,$85,$dd,$33,$01,$21,$00,$56,$16,$00,$3a ; 110
        .byt $20,$04,$da,$05,$02,$21,$81,$8f,$0b,$00,$36 ; 111
        .byt $05,$6a,$f1,$e5,$00,$03,$80,$c3,$e5,$00,$36 ; 112
        .byt $07,$15,$ec,$26,$00,$02,$00,$f8,$16,$00,$3a ; 113
        .byt $05,$9d,$67,$35,$00,$01,$00,$df,$05,$00,$38 ; 114
        .byt $18,$96,$fa,$28,$00,$12,$00,$f8,$e5,$00,$3a ; 115
        .byt $10,$86,$a8,$07,$00,$00,$03,$fa,$03,$00,$36 ; 116
        .byt $11,$41,$f8,$47,$02,$10,$03,$f3,$03,$00,$34 ; 117
        .byt $01,$8e,$f1,$06,$02,$10,$00,$f3,$02,$00,$3e ; 118
        .byt $0e,$00,$1f,$00,$00,$c0,$00,$1f,$ff,$03,$3e ; 119
        .byt $06,$80,$f8,$24,$00,$03,$88,$56,$84,$02,$3e ; 120
        .byt $0e,$00,$f8,$00,$00,$d0,$05,$34,$04,$03,$3e ; 121
        .byt $0e,$00,$f6,$00,$00,$c0,$00,$1f,$02,$03,$3e ; 122
        .byt $d5,$95,$37,$a3,$00,$da,$40,$56,$37,$00,$30 ; 123
        .byt $35,$5c,$b2,$61,$02,$14,$08,$f4,$15,$00,$3a ; 124
        .byt $0e,$00,$f6,$00,$00,$d0,$00,$4f,$f5,$03,$3e ; 125
        .byt $26,$00,$ff,$01,$00,$e4,$00,$12,$16,$01,$3e ; 126
        .byt $00,$00,$f3,$f0,$00,$00,$00,$f6,$c9,$02,$3e ; 127
        .byt $00,$3f,$00,$f0,$00,$00,$3f,$00,$f0,$00,$30 ; 0
        .byt $00,$3f,$00,$f0,$00,$00,$3f,$00,$f0,$00,$30 ; 1
        .byt $00,$3f,$00,$f0,$00,$00,$3f,$00,$f0,$00,$30 ; 2
        .byt $00,$3f,$00,$f0,$00,$00,$3f,$00,$f0,$00,$30 ; 3
        .byt $00,$3f,$00,$f0,$00,$00,$3f,$00,$f0,$00,$30 ; 4
        .byt $00,$3f,$00,$f0,$00,$00,$3f,$00,$f0,$00,$30 ; 5
        .byt $00,$3f,$00,$f0,$00,$00,$3f,$00,$f0,$00,$30 ; 6
        .byt $00,$3f,$00,$f0,$00,$00,$3f,$00,$f0,$00,$30 ; 7
        .byt $00,$3f,$00,$f0,$00,$00,$3f,$00,$f0,$00,$30 ; 8
        .byt $00,$3f,$00,$f0,$00,$00,$3f,$00,$f0,$00,$30 ; 9
        .byt $00,$3f,$00,$f0,$00,$00,$3f,$00,$f0,$00,$30 ; 10
        .byt $00,$3f,$00,$f0,$00,$00,$3f,$00,$f0,$00,$30 ; 11
        .byt $00,$3f,$00,$f0,$00,$00,$3f,$00,$f0,$00,$30 ; 12
        .byt $00,$3f,$00,$f0,$00,$00,$3f,$00,$f0,$00,$30 ; 13
        .byt $00,$3f,$00,$f0,$00,$00,$3f,$00,$f0,$00,$30 ; 14
        .byt $00,$3f,$00,$f0,$00,$00,$3f,$00,$f0,$00,$30 ; 15
        .byt $00,$3f,$00,$f0,$00,$00,$3f,$00,$f0,$00,$30 ; 16
        .byt $00,$3f,$00,$f0,$00,$00,$3f,$00,$f0,$00,$30 ; 17
        .byt $00,$3f,$00,$f0,$00,$00,$3f,$00,$f0,$00,$30 ; 18
        .byt $00,$3f,$00,$f0,$00,$00,$3f,$00,$f0,$00,$30 ; 19
        .byt $00,$3f,$00,$f0,$00,$00,$3f,$00,$f0,$00,$30 ; 20
        .byt $00,$3f,$00,$f0,$00,$00,$3f,$00,$f0,$00,$30 ; 21
        .byt $00,$3f,$00,$f0,$00,$00,$3f,$00,$f0,$00,$30 ; 22
        .byt $00,$3f,$00,$f0,$00,$00,$3f,$00,$f0,$00,$30 ; 23
        .byt $00,$3f,$00,$f0,$00,$00,$3f,$00,$f0,$00,$30 ; 24
        .byt $00,$3f,$00,$f0,$00,$00,$3f,$00,$f0,$00,$30 ; 25
        .byt $00,$3f,$00,$f0,$00,$00,$3f,$00,$f0,$00,$30 ; 26
        .byt $00,$3f,$00,$f0,$00,$00,$3f,$00,$f0,$00,$30 ; 27
        .byt $00,$3f,$00,$f0,$00,$00,$3f,$00,$f0,$00,$30 ; 28
        .byt $00,$3f,$00,$f0,$00,$00,$3f,$00,$f0,$00,$30 ; 29
        .byt $00,$3f,$00,$f0,$00,$00,$3f,$00,$f0,$00,$30 ; 30
        .byt $00,$3f,$00,$f0,$00,$00,$3f,$00,$f0,$00,$30 ; 31
        .byt $00,$3f,$00,$f0,$00,$00,$3f,$00,$f0,$00,$30 ; 32
        .byt $00,$3f,$00,$f0,$00,$00,$3f,$00,$f0,$00,$30 ; 33
        .byt $00,$3f,$00,$f0,$00,$00,$3f,$00,$f0,$00,$30 ; 34
        .byt $10,$44,$f8,$77,$02,$11,$00,$f3,$06,$00,$38 ; 35
        .byt $10,$44,$f8,$77,$02,$11,$00,$f3,$06,$00,$38 ; 36
        .byt $02,$07,$f9,$ff,$00,$11,$00,$f8,$ff,$00,$38 ; 37
        .byt $00,$00,$fc,$05,$02,$00,$00,$fa,$17,$00,$3e ; 38
        .byt $00,$02,$ff,$07,$00,$01,$00,$ff,$08,$00,$30 ; 39
        .byt $00,$00,$fc,$05,$02,$00,$00,$fa,$17,$00,$3e ; 40
        .byt $00,$00,$f6,$0c,$00,$00,$00,$f6,$06,$00,$34 ; 41
        .byt $0c,$00,$f6,$08,$00,$12,$00,$fb,$47,$02,$3a ; 42
        .byt $00,$00,$f6,$0c,$00,$00,$00,$f6,$06,$00,$34 ; 43
        .byt $0c,$00,$f6,$08,$00,$12,$05,$7b,$47,$02,$3a ; 44
        .byt $00,$00,$f6,$0c,$00,$00,$00,$f6,$06,$00,$34 ; 45
        .byt $0c,$00,$f6,$02,$00,$12,$00,$cb,$43,$02,$3a ; 46
        .byt $00,$00,$f6,$0c,$00,$00,$00,$f6,$06,$00,$34 ; 47
        .byt $00,$00,$f6,$0c,$00,$00,$00,$f6,$06,$00,$34 ; 48
        .byt $0e,$00,$f6,$00,$00,$d0,$00,$9f,$02,$03,$3e ; 49
        .byt $00,$00,$f6,$0c,$00,$00,$00,$f6,$06,$00,$34 ; 50
        .byt $0e,$08,$f8,$42,$00,$07,$4a,$f4,$e4,$03,$3e ; 51
        .byt $0e,$00,$f5,$30,$00,$d0,$0a,$9f,$02,$00,$3e ; 52
        .byt $0e,$0a,$e4,$e4,$03,$07,$5d,$f5,$e5,$01,$36 ; 53
        .byt $02,$03,$b4,$04,$00,$05,$0a,$97,$f7,$00,$3e ; 54
        .byt $4e,$00,$f6,$00,$00,$9e,$00,$9f,$02,$03,$3e ; 55
        .byt $11,$45,$f8,$37,$02,$10,$08,$f3,$05,$00,$38 ; 56
        .byt $0e,$00,$f6,$00,$00,$d0,$00,$9f,$02,$03,$3e ; 57
        .byt $80,$00,$ff,$03,$03,$10,$0d,$ff,$14,$00,$3c ; 58
        .byt $0e,$08,$f8,$42,$00,$07,$4a,$f4,$e4,$03,$3e ; 59
        .byt $06,$0b,$f5,$0c,$00,$02,$00,$f5,$08,$00,$36 ; 60
        .byt $01,$00,$fa,$bf,$00,$02,$00,$c8,$97,$00,$37 ; 61
        .byt $01,$51,$fa,$87,$00,$01,$00,$fa,$b7,$00,$36 ; 62
        .byt $01,$54,$fa,$8d,$00,$02,$00,$f8,$b8,$00,$36 ; 63
        .byt $01,$59,$fa,$88,$00,$02,$00,$f8,$b6,$00,$36 ; 64
        .byt $01,$00,$f9,$0a,$03,$00,$00,$fa,$06,$00,$3e ; 65
        .byt $00,$80,$f9,$89,$03,$00,$00,$f6,$6c,$00,$3e ; 66
        .byt $03,$80,$f8,$88,$03,$0c,$08,$f6,$b6,$00,$3f ; 67
        .byt $03,$85,$f8,$88,$03,$0c,$00,$f6,$b6,$00,$3f ; 68
        .byt $0e,$40,$76,$4f,$00,$00,$08,$77,$18,$02,$3e ; 69
        .byt $0e,$40,$c8,$49,$00,$03,$00,$9b,$69,$02,$3e ; 70
        .byt $d7,$dc,$ad,$05,$03,$c7,$00,$8d,$05,$00,$3e ; 71
        .byt $d7,$dc,$a8,$04,$03,$c7,$00,$88,$04,$00,$3e ; 72
        .byt $80,$00,$f6,$06,$03,$11,$00,$67,$17,$03,$3e ; 73
        .byt $80,$00,$f5,$05,$02,$11,$09,$46,$16,$03,$3e ; 74
        .byt $06,$3f,$00,$f4,$00,$15,$00,$f7,$f5,$00,$31 ; 75
        .byt $06,$3f,$00,$f4,$03,$12,$00,$f7,$f5,$00,$30 ; 76
        .byt $06,$3f,$00,$f4,$00,$12,$00,$f7,$f5,$00,$31 ; 77
        .byt $01,$58,$67,$e7,$00,$02,$00,$75,$07,$00,$30 ; 78
        .byt $41,$45,$f8,$48,$00,$42,$08,$75,$05,$00,$30 ; 79
        .byt $0a,$40,$e0,$f0,$03,$1e,$4e,$ff,$05,$00,$38 ; 80
        .byt $0a,$7c,$e0,$f0,$03,$1e,$52,$ff,$02,$00,$38 ; 81
        .byt $0e,$40,$7a,$4a,$00,$00,$08,$7b,$1b,$02,$3e ; 82
        .byt $0e,$0a,$e4,$e4,$03,$07,$40,$55,$39,$01,$36 ; 83
        .byt $05,$05,$f9,$32,$03,$04,$40,$d6,$a5,$00,$3e ; 84
        .byt $02,$3f,$00,$f3,$03,$15,$00,$f7,$f5,$00,$38 ; 85
        .byt $01,$4f,$fa,$8d,$00,$02,$00,$f8,$b5,$00,$37 ; 86
        .byt $00,$00,$f6,$0c,$00,$00,$00,$f6,$06,$00,$34 ; 87
        .byt $00,$3f,$00,$f0,$00,$00,$3f,$00,$f0,$00,$30 ; 88
        .byt $00,$3f,$00,$f0,$00,$00,$3f,$00,$f0,$00,$30 ; 89
        .byt $00,$3f,$00,$f0,$00,$00,$3f,$00,$f0,$00,$30 ; 90
        .byt $00,$3f,$00,$f0,$00,$00,$3f,$00,$f0,$00,$30 ; 91
        .byt $00,$3f,$00,$f0,$00,$00,$3f,$00,$f0,$00,$30 ; 92
        .byt $00,$3f,$00,$f0,$00,$00,$3f,$00,$f0,$00,$30 ; 93
        .byt $00,$3f,$00,$f0,$00,$00,$3f,$00,$f0,$00,$30 ; 94
        .byt $00,$3f,$00,$f0,$00,$00,$3f,$00,$f0,$00,$30 ; 95
        .byt $00,$3f,$00,$f0,$00,$00,$3f,$00,$f0,$00,$30 ; 96
        .byt $00,$3f,$00,$f0,$00,$00,$3f,$00,$f0,$00,$30 ; 97
        .byt $00,$3f,$00,$f0,$00,$00,$3f,$00,$f0,$00,$30 ; 98
        .byt $00,$3f,$00,$f0,$00,$00,$3f,$00,$f0,$00,$30 ; 99
        .byt $00,$3f,$00,$f0,$00,$00,$3f,$00,$f0,$00,$30 ; 100
        .byt $00,$3f,$00,$f0,$00,$00,$3f,$00,$f0,$00,$30 ; 101
        .byt $00,$3f,$00,$f0,$00,$00,$3f,$00,$f0,$00,$30 ; 102
        .byt $00,$3f,$00,$f0,$00,$00,$3f,$00,$f0,$00,$30 ; 103
        .byt $00,$3f,$00,$f0,$00,$00,$3f,$00,$f0,$00,$30 ; 104
        .byt $00,$3f,$00,$f0,$00,$00,$3f,$00,$f0,$00,$30 ; 105
        .byt $00,$3f,$00,$f0,$00,$00,$3f,$00,$f0,$00,$30 ; 106
        .byt $00,$3f,$00,$f0,$00,$00,$3f,$00,$f0,$00,$30 ; 107
        .byt $00,$3f,$00,$f0,$00,$00,$3f,$00,$f0,$00,$30 ; 108
        .byt $00,$3f,$00,$f0,$00,$00,$3f,$00,$f0,$00,$30 ; 109
        .byt $00,$3f,$00,$f0,$00,$00,$3f,$00,$f0,$00,$30 ; 110
        .byt $00,$3f,$00,$f0,$00,$00,$3f,$00,$f0,$00,$30 ; 111
        .byt $00,$3f,$00,$f0,$00,$00,$3f,$00,$f0,$00,$30 ; 112
        .byt $00,$3f,$00,$f0,$00,$00,$3f,$00,$f0,$00,$30 ; 113
        .byt $00,$3f,$00,$f0,$00,$00,$3f,$00,$f0,$00,$30 ; 114
        .byt $00,$3f,$00,$f0,$00,$00,$3f,$00,$f0,$00,$30 ; 115
        .byt $00,$3f,$00,$f0,$00,$00,$3f,$00,$f0,$00,$30 ; 116
        .byt $00,$3f,$00,$f0,$00,$00,$3f,$00,$f0,$00,$30 ; 117
        .byt $00,$3f,$00,$f0,$00,$00,$3f,$00,$f0,$00,$30 ; 118
        .byt $00,$3f,$00,$f0,$00,$00,$3f,$00,$f0,$00,$30 ; 119
        .byt $00,$3f,$00,$f0,$00,$00,$3f,$00,$f0,$00,$30 ; 120
        .byt $00,$3f,$00,$f0,$00,$00,$3f,$00,$f0,$00,$30 ; 121
        .byt $00,$3f,$00,$f0,$00,$00,$3f,$00,$f0,$00,$30 ; 122
        .byt $00,$3f,$00,$f0,$00,$00,$3f,$00,$f0,$00,$30 ; 123
        .byt $00,$3f,$00,$f0,$00,$00,$3f,$00,$f0,$00,$30 ; 124
        .byt $00,$3f,$00,$f0,$00,$00,$3f,$00,$f0,$00,$30 ; 125
        .byt $00,$3f,$00,$f0,$00,$00,$3f,$00,$f0,$00,$30 ; 126
        .byt $00,$3f,$00,$f0,$00,$00,$3f,$00,$f0,$00,$30 ; 127

general_midi_percussion_note_number:
        .byt $00,$00,$00,$00,$00,$00,$00,$00
        .byt $00,$00,$00,$00,$00,$00,$00,$00
        .byt $00,$00,$00,$00,$00,$00,$00,$00
        .byt $00,$00,$00,$00,$00,$00,$00,$00
        .byt $00,$00,$00,$23,$23,$34,$30,$3a
        .byt $3c,$2f,$2b,$31,$2b,$33,$2b,$36
        .byt $39,$48,$3c,$4c,$54,$24,$41,$54
        .byt $53,$54,$18,$4d,$3c,$41,$3b,$33
        .byt $2d,$47,$3c,$3a,$35,$40,$47,$3d
        .byt $3d,$2c,$28,$45,$44,$3f,$4a,$3c
        .byt $50,$40,$48,$49,$46,$44,$30,$35
        .byt $00,$00,$00,$00,$00,$00,$00,$00
        .byt $00,$00,$00,$00,$00,$00,$00,$00
        .byt $00,$00,$00,$00,$00,$00,$00,$00
        .byt $00,$00,$00,$00,$00,$00,$00,$00
        .byt $00,$00,$00,$00,$00,$00,$00,$00

        endif
