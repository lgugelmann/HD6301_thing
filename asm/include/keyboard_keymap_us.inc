        ifndef __keyboard_keymap_us_inc
__keyboard_keymap_us_inc = 1

; NOTES:
; - Enter ($5a) maps to LF ($0a), shifted or not
; - Backspace ($66) maps to ^H ($08)
; Some characters don't fit into ASCII, we map them to >127
; - Left (extended $6B) maps to $80
; - Right (extended $74) maps to $81
; - Up (extended $75) maps to $82
; - Down (extended $72) maps to $83

keycode_to_ascii:
        ;      0   1   2   3   4   5   6   7   8   9   a   b   c   d   e   f
        .byt $00,$00,$00,$00,$00,$00,$00,$00,$00,$00,$00,$00,$00,$09,"`",$00 ; 0
        .byt $00,$00,$00,$00,$00,"q","1",$00,$00,$00,"z","s","a","w","2",$00 ; 1
        .byt $00,"c","x","d","e","4","3",$00,$00," ","v","f","t","r","5",$00 ; 2
        .byt $00,"n","b","h","g","y","6",$00,$00,$00,"m","j","u","7","8",$00 ; 3
        .byt $00,",","k","i","o","0","9",$00,$00,".","/","l",";","p","-",$00 ; 4
        .byt $00,$00,"'",$00,"[","=",$00,$00,$00,$00,$0a,"]",$00,"\\",$00,$00; 5
        .byt $00,$00,$00,$00,$00,$00,$08,$00,$00,$00,$00,$00,$00,$00,$00,$00 ; 6
        .byt $00,$00,$00,$00,$00,$00,$00,$00,$00,$00,$00,$00,$00,$00,$00,$00 ; 7
        .byt $00,$00,$00,$00,$00,$00,$00,$00,$00,$00,$00,$00,$00,$00,$00,$00 ; 8
        .byt $00,$00,$00,$00,$00,$00,$00,$00,$00,$00,$00,$00,$00,$00,$00,$00 ; 9
        .byt $00,$00,$00,$00,$00,$00,$00,$00,$00,$00,$00,$00,$00,$00,$00,$00 ; a
        .byt $00,$00,$00,$00,$00,$00,$00,$00,$00,$00,$00,$00,$00,$00,$00,$00 ; b
        .byt $00,$00,$00,$00,$00,$00,$00,$00,$00,$00,$00,$00,$00,$00,$00,$00 ; c
        .byt $00,$00,$00,$00,$00,$00,$00,$00,$00,$00,$00,$00,$00,$00,$00,$00 ; d
        .byt $00,$00,$00,$00,$00,$00,$00,$00,$00,$00,$00,$00,$00,$00,$00,$00 ; e
        .byt $00,$00,$00,$00,$00,$00,$00,$00,$00,$00,$00,$00,$00,$00,$00,$00 ; f

keycode_to_ascii_shifted:
        ;      0   1   2   3   4   5   6   7   8   9   a   b   c   d   e   f
        .byt $00,$00,$00,$00,$00,$00,$00,$00,$00,$00,$00,$00,$00,$00,"~",$00 ; 0
        .byt $00,$00,$00,$00,$00,"Q","!",$00,$00,$00,"Z","S","A","W","@",$00 ; 1
        .byt $00,"C","X","D","E","$","#",$00,$00," ","V","F","T","R","%",$00 ; 2
        .byt $00,"N","B","H","G","Y","^",$00,$00,$00,"M","J","U","&","*",$00 ; 3
        .byt $00,"<","K","I","O",")","(",$00,$00,">","?","L",":","P","_",$00 ; 4
        .byt $00,$00,"\"",$00,"{","+",$00,$00,$00,$00,$0a,"}",$00,"|",$00,$00; 5
        .byt $00,$00,$00,$00,$00,$00,$08,$00,$00,$00,$00,$00,$00,$00,$00,$00 ; 6
        .byt $00,$00,$00,$00,$00,$00,$00,$00,$00,$00,$00,$00,$00,$00,$00,$00 ; 7
        .byt $00,$00,$00,$00,$00,$00,$00,$00,$00,$00,$00,$00,$00,$00,$00,$00 ; 8
        .byt $00,$00,$00,$00,$00,$00,$00,$00,$00,$00,$00,$00,$00,$00,$00,$00 ; 9
        .byt $00,$00,$00,$00,$00,$00,$00,$00,$00,$00,$00,$00,$00,$00,$00,$00 ; a
        .byt $00,$00,$00,$00,$00,$00,$00,$00,$00,$00,$00,$00,$00,$00,$00,$00 ; b
        .byt $00,$00,$00,$00,$00,$00,$00,$00,$00,$00,$00,$00,$00,$00,$00,$00 ; c
        .byt $00,$00,$00,$00,$00,$00,$00,$00,$00,$00,$00,$00,$00,$00,$00,$00 ; d
        .byt $00,$00,$00,$00,$00,$00,$00,$00,$00,$00,$00,$00,$00,$00,$00,$00 ; e
        .byt $00,$00,$00,$00,$00,$00,$00,$00,$00,$00,$00,$00,$00,$00,$00,$00 ; f

keycode_to_ascii_extended:
        ;      0   1   2   3   4   5   6   7   8   9   a   b   c   d   e   f
        .byt $00,$00,$00,$00,$00,$00,$00,$00,$00,$00,$00,$00,$00,$00,$00,$00 ; 0
        .byt $00,$00,$00,$00,$00,$00,$00,$00,$00,$00,$00,$00,$00,$00,$00,$00 ; 1
        .byt $00,$00,$00,$00,$00,$00,$00,$00,$00,$00,$00,$00,$00,$00,$00,$00 ; 2
        .byt $00,$00,$00,$00,$00,$00,$00,$00,$00,$00,$00,$00,$00,$00,$00,$00 ; 3
        .byt $00,$00,$00,$00,$00,$00,$00,$00,$00,$00,$00,$00,$00,$00,$00,$00 ; 4
        .byt $00,$00,$00,$00,$00,$00,$00,$00,$00,$00,$00,$00,$00,$00,$00,$00 ; 5
        .byt $00,$00,$00,$00,$00,$00,$00,$00,$00,$00,$00,$80,$00,$00,$00,$00 ; 6
        .byt $00,$00,$83,$00,$81,$82,$00,$00,$00,$00,$00,$00,$00,$00,$00,$00 ; 7
        .byt $00,$00,$00,$00,$00,$00,$00,$00,$00,$00,$00,$00,$00,$00,$00,$00 ; 8
        .byt $00,$00,$00,$00,$00,$00,$00,$00,$00,$00,$00,$00,$00,$00,$00,$00 ; 9
        .byt $00,$00,$00,$00,$00,$00,$00,$00,$00,$00,$00,$00,$00,$00,$00,$00 ; a
        .byt $00,$00,$00,$00,$00,$00,$00,$00,$00,$00,$00,$00,$00,$00,$00,$00 ; b
        .byt $00,$00,$00,$00,$00,$00,$00,$00,$00,$00,$00,$00,$00,$00,$00,$00 ; c
        .byt $00,$00,$00,$00,$00,$00,$00,$00,$00,$00,$00,$00,$00,$00,$00,$00 ; d
        .byt $00,$00,$00,$00,$00,$00,$00,$00,$00,$00,$00,$00,$00,$00,$00,$00 ; e
        .byt $00,$00,$00,$00,$00,$00,$00,$00,$00,$00,$00,$00,$00,$00,$00,$00 ; f

        endif
